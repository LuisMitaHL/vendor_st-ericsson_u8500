; default_break.cmm
;------------------------------------------------------------
; Startup file to set default breakpoint
;
; 061103 - KM Initial version
; 070314 - KM added check if symbol exist
; 070405 - PH Adaption to fit new startup.cmm
;-----------------------------------------------------------

if y.exist(ErrorHandler)
  b.s ErrorHandler

ENDDO