area.create bparam 170 160
area.clear bparam
area.select bparam
area bparam

data.string (ubsp_board_parameters)++(1000)
data.string (ubsp_board_parameters+1000)++(1000)
data.string (ubsp_board_parameters+2000)++(1000)
data.string (ubsp_board_parameters+3000)++(1000)
data.string (ubsp_board_parameters+4000)++(1000)

area.select
enddo


