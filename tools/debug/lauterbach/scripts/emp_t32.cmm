;Default startup program for TRACE32
;
;This startup program can be modified according to your needs.

;choose hex mode for input
 radix hex

;Add some extra buttons to the toolbar

 menu.rp
 (
 add
 toolbar
  (
   separator
   toolitem "Source/List" "list" "Data.List"
   toolitem "Memory Dump" "dump" "Data.dump"
   toolitem "Register" "reg" "Register"
   toolitem "Watch" ":varwatch" "Var.Watch"
   toolitem "Stack" ":varframe" "Var.Frame /l /c"
   toolitem "Automatic Watch" ":varref" "Var.Ref"
   toolitem "List Breakpoints" "break" "Break.List"
   toolitem "List Symbols" "symbols" "sYmbol.Browse"
   separator
   )
 )

 if language()!=""
 (
  local &menuname
  &menuname="~~/t32"+language()
  menu.rp &menuname
 )

;Recall and Define History File
 autostore , history bookmark

 enddo
