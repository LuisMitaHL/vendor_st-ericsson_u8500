// Autoload script, called by TRACE32 if symbols are to be loaded

// define local macros
 local &filename &basename &progname &symfilename1 &symfilename2 &filepath &code &data &space

// get filename and relocation information
 // these parameters are passed from TRACE32 when calling this skript

 entry &filename &type &code &data &space

 //print "autoload: " &filename " " &type " " &code " " &data " " &space

 // &filename:      name of process/file
 // &type:          type of file: 1=process, 2=library, 3=kernel module
 // &code:          text segment address
 // &data:          data segment address
 // &space:         space id of process

// get symbol file name and program name
 &basename=string.cut(&filename,-string.len(os.file.extension(&filename)))
 &android_out=os.env(ANDROID_PRODUCT_OUT)
 if string.len("&android_out")==0
 (
   if string.len("&SrcPath")!=0
   (
     &android_out="&SrcPath/out/target/product/&targetFamily"
   )
 )
 if (&type==1)
 (
   &symfilename1="&basename"
   &symfilename2=&filename
   if string.len("&android_out")!=0
   (
      y.spath + "&android_out/symbols/system/bin"
      y.spath + "&android_out/symbols/system/xbin"
      y.spath + "&android_out/symbols/sbin"
   )
 )
 if ((&type&0xffff)==2)
 (
   &symfilename1=&filename
   &symfilename2="&basename"+".so"
   if string.len("&android_out")!=0
   (
      y.spath.setrecursedir + "&android_out/symbols/system/lib"
      y.spath.setrecursedir + "&android_out/symbols/system/usr/lib"
   )
 )
 if (&type==3)
 (
   if "&mod_debug_name"=="&basename"    ; changed file name in mod_debug.cmm?
     &symfilename1="&mod_debug_file"+".ko"
   else
     &symfilename1="&basename"+".ko"
   &symfilename2=&filename
   if string.len("&android_out")!=0
   (
      y.spath.setrecursedir + "&android_out/system/lib/modules"
      y.spath.setrecursedir + "&android_out/system/modules"
   )
 )
 &progname=os.file.name("&basename")

// delete symbols if they already exist
 if y.exist("\\&progname")
   sYmbol.Delete \\&progname
 GROUP.Delete "&progname"

// search file in source search path and open dialog when not there
 &filepath=y.searchfile("&symfilename1")
 if !os.file("&filepath")
    &filepath=y.searchfile("&symfilename2")
 if !os.file("&filepath")
 (
   local &file &spath
   &file=os.file.name("&symfilename1")
   winpos ,,,,,, filebox normal "Searching symbols for &filename"
   dialog.file "*\&file"
   entry %line &filepath
   if "&filepath"==""
     enddo
   &spath=os.file.path("&filepath")
   sYmbol.SourcePATH.Set &spath
 )

// load symbol file (options for sourcepath, e.g. /STRIPPART may need to be added when required)

 if (&type==1)  // processes
 (
   Data.LOAD.Elf "&filepath" &space:0 /nocode /noclear
   if task.y.o(mmuscan)==1      // scan only if TRANSlation.TABLEWALK not configured
     MMU.TaskPageTable.SCAN &space:0
   GROUP.Create "&progname" &space:0x0--0xffffffff /GREEN
 )

 if (&type==3)  // modules
 (
   local  &reloc &magic &secaddr &secname

   &magic=task.mod.magic("&progname")

   &reloc=""
   &i=1
   &secaddr=task.mod.secaddr(&magic,&i)
   while &secaddr!=0xffffffff
   (
     &secname=task.mod.secname(&magic,&i)
     &reloc="&reloc"+" /reloc &secname at &secaddr"
     &i=&i+1
     &secaddr=task.mod.secaddr(&magic,&i)
   )

   Data.LOAD.Elf &filepath 0:0 /nocode /noclear \
     /name &progname &reloc
   ;MMU.SCAN ALL     // not necessary: done by TRANSlation.TABLEWALK
   GROUP.Create "&progname" y.secrange(\\&progname\.text) /YELLOW
 )

 if ((&type&0xffff)==2) // libraries
 (
   if "&space"==""
     &space=0
   Data.LOAD.Elf &filepath &space:&code /nocode /noclear
 )

 enddo

