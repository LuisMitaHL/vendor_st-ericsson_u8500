// Fill registers from dmesg.txt during a kernel bug

screen.off

global &space_id &cpu_core &tid &process_name
local &logfile &nodump
entry &logfile &nodump

; Default values, they will be updated in the script linux-bug-fill-register.pl
&space_id=0.
&cpu_core=0.


if "&logfile"=="dmesg"
(
	if !os.file("dmesg.txt")
	(
		do dmesg
	)
)
else if "&logfile"=="logcat"
(
	if !os.file("logcat_main.txt")
	(
		do logcat_extr
	)
)

dialog
(
	header "Setup registers"

	pos 1. 0. 4.
	TEXT "R0:"
	POS 5. 0. 12.
r0:		EDIT "" ""

	pos 1. 1. 4.
	TEXT "R1:"
	POS 5. 1. 12.
r1:		EDIT "" ""

	pos 1. 2. 4.
	TEXT "R2:"
	POS 5. 2. 12.
r2:		EDIT "" ""

	pos 1. 3. 4.
	TEXT "R3:"
	POS 5. 3. 12.
r3:		EDIT "" ""

	pos 1. 4. 4.
	TEXT "R4:"
	POS 5. 4. 12.
r4:		EDIT "" ""

	pos 20. 0. 4.
	TEXT "R5:"
	POS 24. 0. 12.
r5:		EDIT "" ""

	pos 20. 1. 4.
	TEXT "R6:"
	POS 24. 1. 12.
r6:		EDIT "" ""

	pos 20. 2. 4.
	TEXT "R7:"
	POS 24. 2. 12.
r7:		EDIT "" ""

	pos 20. 3. 4.
	TEXT "R8:"
	POS 24. 3. 12.
r8:		EDIT "" ""

	pos 20. 4. 4.
	TEXT "R9:"
	POS 24. 4. 12.
r9:		EDIT "" ""

	pos 38. 0. 4.
	TEXT "R10:"
	POS 43. 0. 12.
r10:	EDIT "" ""

	pos 38. 1. 4.
	TEXT "R11:"
	POS 43. 1. 12.
r11:	EDIT "" ""

	pos 38. 2. 4.
	TEXT "R12:"
	POS 43. 2. 12.
r12:	EDIT "" ""

	pos 38. 3. 4.
	TEXT "R13:"
	POS 43. 3. 12.
r13:	EDIT "" ""

	pos 38. 4. 4.
	TEXT "R14:"
	POS 43. 4. 12.
r14:	EDIT "" ""

	pos 57. 0. 4.
	TEXT "PC:"
	POS 62. 0. 12.
r15:	EDIT "" ""

	pos 57. 1. 4.
	TEXT "CPSR:"
	POS 62. 1. 12.
cpsr:	EDIT "" ""

	pos 57. 2. 4.
	TEXT "Ctrl:"
	POS 62. 2. 12.
ctrl:	EDIT "" ""

	pos 57. 3. 4.
	TEXT "Table:"
	POS 62. 3. 12.
table:	EDIT "" ""

	pos 57. 4. 4.
	TEXT "DAC:"
	POS 62. 4. 12.
dac:	EDIT "" ""

pos 33. 6. 12.
	DEFBUTTON "OK" "continue"
)


if "&logfile"=="dmesg"
(
	print "os.area perl '&(toolsPath)/linux-bug-fill-register.pl' 'dmesg.txt' 'registers_dmesg.cmm'"
	os.area perl "&(toolsPath)/linux-bug-fill-register.pl" "dmesg.txt" "registers_dmesg.cmm" &nodump
)
else if "&logfile"=="logcat"
(
	print "os.area perl '&(toolsPath)/linux-bug-fill-register.pl' 'logcat_main.txt' 'registers_dmesg.cmm'"
	os.area perl "&(toolsPath)/linux-bug-fill-register.pl" "logcat_main.txt" "registers_dmesg.cmm"
)

do registers_dmesg.cmm

stop

&r0=dialog.string(r0)
&r1=dialog.string(r1)
&r2=dialog.string(r2)
&r3=dialog.string(r3)
&r4=dialog.string(r4)
&r5=dialog.string(r5)
&r6=dialog.string(r6)
&r7=dialog.string(r7)
&r8=dialog.string(r8)
&r9=dialog.string(r9)
&r10=dialog.string(r10)
&r11=dialog.string(r11)
&r12=dialog.string(r12)
&r13=dialog.string(r13)
&r14=dialog.string(r14)
&r15=dialog.string(r15)
&cpsr=dialog.string(cpsr)
&ctrl=dialog.string(ctrl)
&table=dialog.string(table)
&dac=dialog.string(dac)

dialog.end


if "&logfile"=="dmesg"
(
	CORE.Select &cpu_core
	r.s cpsr &cpsr /TASK &space_id /CORE &cpu_core
	r.s r0 &r0 /TASK &space_id /CORE &cpu_core
	r.s r1 &r1 /TASK &space_id /CORE &cpu_core
	r.s r2 &r2 /TASK &space_id /CORE &cpu_core
	r.s r3 &r3 /TASK &space_id /CORE &cpu_core
	r.s r4 &r4 /TASK &space_id /CORE &cpu_core
	r.s r5 &r5 /TASK &space_id /CORE &cpu_core
	r.s r6 &r6 /TASK &space_id /CORE &cpu_core
	r.s r7 &r7 /TASK &space_id /CORE &cpu_core
	r.s r8 &r8 /TASK &space_id /CORE &cpu_core
	r.s r9 &r9 /TASK &space_id /CORE &cpu_core
	r.s r10 &r10 /TASK &space_id /CORE &cpu_core
	r.s r11 &r11 /TASK &space_id /CORE &cpu_core
	r.s r12 &r12 /TASK &space_id /CORE &cpu_core
	r.s r13 &r13 /TASK &space_id /CORE &cpu_core
	r.s r14 &r14 /TASK &space_id /CORE &cpu_core
	r.s pc &r15 /TASK &space_id /CORE &cpu_core
	per.s c15:0x1 %LONG &ctrl
	per.s c15:0x2 %LONG &table
	per.s c15:0x3 %LONG &dac
)
else
(
	CORE.Select 1.
	&magic_addr=TASK.CONFIG(magic)
	&task_magic= TASK.PROC.MAGIC("&process_name")
	D.S &magic_addr %LE %LONG &task_magic
	register.task "&process_name"
	CORE.Select 0.
	per.s c15:0x1 %LONG 0x10c57c7d
;	per.s c15:0x2 %LONG 0x0b07804a
	per.s c15:0x3 %LONG 0x15
	r.s cpsr &cpsr /TASK &space_id /CORE 0
	r.s r0 &r0 /TASK &space_id /CORE 0
	r.s r1 &r1 /TASK &space_id /CORE 0
	r.s r2 &r2 /TASK &space_id /CORE 0
	r.s r3 &r3 /TASK &space_id /CORE 0
	r.s r4 &r4 /TASK &space_id /CORE 0
	r.s r5 &r5 /TASK &space_id /CORE 0
	r.s r6 &r6 /TASK &space_id /CORE 0
	r.s r7 &r7 /TASK &space_id /CORE 0
	r.s r8 &r8 /TASK &space_id /CORE 0
	r.s r9 &r9 /TASK &space_id /CORE 0
	r.s r10 &r10 /TASK &space_id /CORE 0
	r.s r11 &r11 /TASK &space_id /CORE 0
	r.s r12 &r12 /TASK &space_id /CORE 0
	r.s r13 &r13 /TASK &space_id /CORE 0
	r.s r14 &r14 /TASK &space_id /CORE 0
	r.s pc &r15 /TASK &space_id /CORE 0
	CORE.Select 0.
	register.task "&process_name"
)


screen.on
enddo

