; #####################################################################
; # DB8500 debug & Trace script file: mmterm.cmm                      #
; # Copyright (C) 2011, STMicroelectronics. All Rights Reserved       #
; #####################################################################
; Created by HED/CSP/CPT/ACT on 2009-03-05

term.reset
term.method mmdspio
term.mode string
term.scroll ON
WINPOS 103.13 0.0 50. 59. 0. 0. W000
term.size 200 300 
term.gate
