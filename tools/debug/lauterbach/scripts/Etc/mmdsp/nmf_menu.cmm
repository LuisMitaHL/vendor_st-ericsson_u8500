; nmf_menu.cmm
;------------------------------------------------------------
; Add some nmf specific short cut in toolbar
;
; 120213 - Initial version
;-----------------------------------------------------------

menu.rp
(
	add
	toolbar
	(
		toolitem "NMF Graph" "do nmf_graph.cmm"
[;;;;;;;;;;;;;;;;
                ;
    XXXXXXXX    ;
    X      X    ;
  RRX      XRR  ;
  R X      X R  ;
  R XXXXXXXX R  ;
  R          R  ;
  R          R  ;
RRRRR      RRRRR;
 RRR        RRR ;
  R          R  ;
XXXXXX g  XXXXXX;
XCCCCX gg XCCCCX;
XCCCCXggggXCCCCX;
XCCCCX gg XCCCCX;
XXXXXX g  XXXXXX;
];;;;;;;;;;;;;;;;

		toolitem "Rescan Memory" "do updatemodules"
[;;;;;;;;;;;;;;;;
      XXXX      ;
    XXggggXX XX ;
   XggggggggXgX ;
  XgggggggggggX ;
 XggggXXXgggggX ;
XggggX   XggggX ;
 XggX   XgggggX ;
  XX    XXXXXXX ;
 XXXXXXX    XX  ;
 XgggggX   XggX ;
 XggggX   XggggX;
 XgggggXXXggggX ;
 XgggggggggggX  ;
 XgXggggggggX   ;
 XX XXggggXX    ;
      XXXX      ;
];;;;;;;;;;;;;;;;
	)
)
