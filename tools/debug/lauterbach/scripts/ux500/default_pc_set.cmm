; default_pc_set.cmm
;------------------------------------------------------------
; Startup file to set Program Counter
;
; 091210 - KM Initial version
;-----------------------------------------------------------



ENDDO