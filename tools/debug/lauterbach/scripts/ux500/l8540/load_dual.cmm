;------------------------------------------------------------
; load_dual.cmm
;------------------------------------------------------------
; Startup file to select and setup target
;
;-----------------------------------------------------------
; This file set up all cores
;-----------------------------------------------------------

local &masterCpu
local &masterIc

;Load master is "current" core, e.g. core where load is pressed
&masterCpu="&targetCpu"

if simulator()
(
	; on simulator : intercom not needed, load on each instance
	&MmdspSiaStarted="False"
	&AppStarted="False"

	if ("&targetCpu"=="mmdsp")
	(
		if (STR.SCAN(OS.ID(),"SIA",0)>=0)
		(
			&MmdspSiaStarted="True"
		)
	)
	else if ("&targetCpu"=="app")
		&AppStarted="True"

	; load only the current target
	do load_target
)
else
(
gosub getIcPort &masterCpu
entry &masterIc

;Check if we are running in load master, if not do a intercom call
if "&masterCpu"!="&targetCpu"
(
	intercom.execute &masterIc do load_dual.cmm
	enddo
)

;What cores are we debugging?
if INTERCOM.PING(&icMmdspSia)
	&MmdspSiaStarted="True"
if INTERCOM.PING(&icApp)
	&AppStarted="True"

;Load master first
gosub loadOne &masterCpu
)

enddo



loadOne:
	ENTRY &Cpu
	if ("&MmdspSiaStarted"=="True")
		intercom.executenowait &icMmdspSia print "Waiting for &Cpu to load software"
	if ("&AppStarted"=="True")
		intercom.executenowait &icApp print "Waiting for &Cpu to load software"

	gosub getIcPort &Cpu
	entry &icPort
	intercom.executenowait &icPort print "Load software"
	intercom.execute &icPort do load_target

	return

waitUntilLoaded:
	entry &cpu

	;Wait until load is complete, don't wait if load cpu is running this script
	if ("&masterCpu"!="&cpu")
	(
		gosub getIcPort &cpu
		entry &icCpu
		intercom.wait &icCpu
	)
	return

getIcPort:
	ENTRY &Cpu
        &result=""
	if ("&Cpu"=="mmdsp")
        (
            if (STR.SCAN(OS.ID(),"SIA",0)>=0)
            (
		&result="&icMmdspSia"
            )
        )
	else if ("&Cpu"=="app")
		&result="&icApp"

	if ("&result"=="")
        (
           print %error "Unknown CPU &Cpu "+OS.ID()+" in "+os.ppd()+"getIcPort()"
        )

	return &result

