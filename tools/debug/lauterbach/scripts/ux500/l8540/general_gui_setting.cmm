;------------------------------------------------------------
; general_gui_settings.cmm
;------------------------------------------------------------
; Override of cpt gui settings
;
; 110526 - KM Initial version
;-----------------------------------------------------------

enddo

