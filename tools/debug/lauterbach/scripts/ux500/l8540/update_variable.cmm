;------------------------------------------------------------
; update_variables.cmm
;------------------------------------------------------------
; Used to synch chip_version from APP to other debuggers
;
; 110617 - KM Initial version
;-----------------------------------------------------------

ENTRY &entry1 &entry2
&chip_version="&entry1"
&PRCMUDebug="&entry2"
enddo