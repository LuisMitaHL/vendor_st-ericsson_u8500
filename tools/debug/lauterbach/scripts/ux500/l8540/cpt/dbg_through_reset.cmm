; #####################################################################
; # L8540 debug & Trace script file: dbg_through_reset.cmm            #
; # Copyright (C) 2011, STMicroelectronics. All Rights Reserved       #
; #####################################################################
; This script performs the "debug through reset" sequence.
; Created by HED/CSP/CPT/ACT on 2012-02-10
; Contact: Jingyi-xiaoyan.lu@st.com

; 2012-03-23: removed the workaround of the hw bug of "Synch on the TCK" which has been fixed on RTL v0.5.1.

entry &nreset_pin &sequence &reset_core

if (string.mid(cpu(),0,6)!="DB8540")
(
	print "Unknown cpu name: ", cpu()
	enddo
)

if (string.upr(cpu())!="DB8540"&&string.upr(cpu())!="DB8540APE-CORE0"&&string.upr(cpu())!="DB8540APE-CORE1"&&string.upr(cpu())!="DB8540XMIPAPE")
(
	print "This script can only be run on a debugger connected to DB8540|DB8540APE-CORE0|1|DB8540XMIPAPE!"
	enddo
)

&reset_core=string.upr("&reset_core")
if "&reset_core"==""
	&reset_core=string.upr(cpu())

if ("&reset_core"!="DB8540"&&"&reset_core"!="DB8540APE-CORE0"&&"&reset_core"!="DB8540APE-CORE1"&&"&reset_core"!="DB8540XMIPAPE")
(
	print "Unknown core name &reset_core !"
	enddo
)


&sequence=string.upr("&sequence")
if "&sequence"==""
	&sequence="DBGREQ"
else if "&sequence"!="CORE_RESET"&&"&sequence"!="DBGREQ"
(
	print "Unknown sequence! &sequence"
	enddo
)

if "&nreset_pin"==""
	&nreset_pin="N"
&nreset_pin=string.upr("&nreset_pin")
if "&nreset_pin"!="Y"&&"&nreset_pin"!="N"
(
	print "Unknown parameter &nreset_pin !"
	enddo
)


if "&nreset_pin"=="Y"
	print "Performing the debug through reset for the cpu: &reset_core, using &sequence, using nSRST pin."
else
(	
	if "&reset_core"=="DB8540XMIPAPE"
		print "Performing the debug through reset for the cpu: &reset_core, using &sequence, using XMIP_EXECTL[POR]."
	else
		print "Performing the debug through reset for the cpu: &reset_core, using &sequence, using APE_EXECTL[POR]."
)

if (string.upr(cpu())=="DB8540XMIPAPE"&&"&nreset_pin"=="Y") //the XMIP reset can only be done by APE core
(
	print "This sequence can only be done under DB8540 APE cores!"
	enddo
)
	

&exectl_addr=0x50003A80
if "&reset_core"=="DB8540XMIPAPE"
	&exectl_addr=0x50003A10

sys.down
sys.o.enreset off
if "&nreset_pin"=="Y"&&"&reset_core"=="DB8540XMIPAPE"
	sys.m.a
else
	sys.m.prepare
&exectl_v=0
if "&sequence"=="DBGREQ"
(
	; --- assert dbg req
	if "&reset_core"=="DB8540"
		&exectl_v=0x60
	else if "&reset_core"=="DB8540APE-CORE0"
		&exectl_v=0x20
	else if "&reset_core"=="DB8540APE-CORE1"
		&exectl_v=0x40
	else if "&reset_core"=="DB8540XMIPAPE"
		&exectl_v=0x20
)
else
(
	; --- assert the core reset
	&exectl_v=0x1
)

if "&nreset_pin"=="N"  //use exectl[POR]
	&exectl_v=&exectl_v|0x1000
else
	d.s edbg:&exectl_addr %word &exectl_v

; --- assert and deassert the PORn
if "&nreset_pin"=="N"
(
	d.s edbg:&exectl_addr %word &exectl_v
	&exectl_v=&exectl_v&~0x1000
	d.s edbg:&exectl_addr %word &exectl_v
)
else
(
	jtag.pin nreset 0
	jtag.pin nreset 1
)

//if "&reset_core"=="DB8540XMIPAPE"
	wait 400ms
//else
//(
//	&ref_v=&exectl_v
//	if "&reset_core"=="DB8540"
//		&ref_v=&ref_v|0x300
//	else if "&reset_core"=="DB8540APE-CORE0"
//		&ref_v=&ref_v|0x100
//	else //"&reset_core"=="DB8540APE-CORE1"
//		&ref_v=&ref_v|0x200
//	&exectl_read_v=d.l(edbg:&exectl_addr)
//	&counter=0
//	while &exectl_read_v!=&ref_v
//	(
//		&counter=&counter+1	
//		&exectl_read_v=d.l(edbg:&exectl_addr)
//	)
//	//print "counter = &counter "
//)

if "&nreset_pin"=="Y"&&"&reset_core"=="DB8540XMIPAPE"
(
	break
	; release XMIP reset
	data.set a:0x801572B0 %l 1
)

if "&sequence"=="CORE_RESET"
(
	; --- program the DRCR 
	&a9ss_base_addr=0x801A0000
	&drcr0_addr=&a9ss_base_addr+0x8090
	&drcr1_addr=&a9ss_base_addr+0xA090

	if "&reset_core"=="DB8540APE-CORE0"
		d.s edap:&drcr0_addr %l d.l(edap:&drcr0_addr)|1
	else if "&reset_core"=="DB8540APE-CORE1"
		d.s edap:&drcr1_addr %l d.l(edap:&drcr1_addr)|1
	else if "&reset_core"=="DB8540"
	(
		d.s edap:&drcr0_addr %l d.l(edap:&drcr0_addr)|1
		d.s edap:&drcr1_addr %l d.l(edap:&drcr1_addr)|1
	)
)

; --- deassert the core reset and dbg_req signals
d.s edbg:&exectl_addr %word 0


sys.down
tronchip.set.reset off
sys.m.a
if string.upr(cpu())=="&reset_core"
(
;--- check the PC
&reset_addr=0
if (d.l(c15:1)>>13.&1)==1
	&reset_addr=0xFFFF0000
&current_core=0
if "&reset_core"=="DB8540"
(
	&current_core=core()
	&failed=0
	core 0
	if run()||r(pc)!=&reset_addr
	(
		print "FAILED! The CORE0 did not stop at reset address!"
		&failed=1
	)
	core 1
	if run()||r(pc)!=&reset_addr
	(
		print "FAILED! The CORE1 did not stop at reset address!"
	)
	core &current_core
	if &failed==1
		enddo
)
else if run()||r(pc)!=&reset_addr
(
	print "FAILED! The core did not stop at reset address!"
	enddo
)
)
print "DONE."
enddo
