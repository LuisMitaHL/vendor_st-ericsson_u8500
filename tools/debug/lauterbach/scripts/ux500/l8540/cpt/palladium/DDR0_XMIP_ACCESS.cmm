; This script is provided by STE. 
; The Author is Abhishek NIRAJ.

		data.set a:80159048 %long d.l(a:0x80159048)|0x3000
		data.set a:80157440 %long d.l(a:0x80157440)|0x2000
		data.set a:80156124 %long d.l(a:0x80156124)|0x8000
		data.set a:8015519C %long 0xFFFF0000
		data.set a:80156124 %long d.l(a:0x80156124)&0xFFFF7FFF
		data.set a:80159038 %long d.l(a:0x80159038)|0x1
		data.set a:80159038 %long d.l(a:0x80159038)|0x2
		
		print " ddr done for XMIP" 
