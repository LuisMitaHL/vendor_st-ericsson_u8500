;------------------------------------------------------------
; linux.cmm
;------------------------------------------------------------
; Linux specific settings
;
; 091207 - KM Initial version
; 110526 - KM Adapted for U5500
;-----------------------------------------------------------

if "&ExeMem"=="RAM"
(
	do a-tag_settings
)

; print "initializing debugger MMU for 256Mb of RAM..."
if y.exist(swapper_pg_dir)
	MMU.FORMAT LINUX swapper_pg_dir 0xc0000000--0xdfffffff 0x00000000
TRANSlation.Create 0xc0000000--0xdfffffff 0x00000000
TRANSlation.COMMON 0xbf000000--0xffffffff
TRANSlation.TableWalk ON   ; debugger uses a table walk to decode virtual addresses
TRANSlation.ON

group.create "Kernel" 0xc0000000--0xdfffffff /RED

;Thread support
;task.o threading tgroup

;Enable this option if kernel is modified to provide thread info using the contextid
task.o thrctx off


; Recommended for Android
TASK.Option NameMode ARG0COMM

;Configure the autoloader, use modified autoloader script on network that use strippart
&temp1="do "
&temp1="&temp1&CMM_PATH_BASE"
&temp2="/autoload.cmm "
&temp1="&temp1&temp2"
sYmbol.AutoLoad.CHECKLINUX "&temp1"

if (STR.SCAN(OS.ID(),"PALLADIUM",0)>=0)
(
print "WARNING: autoload not activated by default for palladium"
)
else
(
;Enable autoload for processes
task.y.o autoload NONE
task.y.o autoload process
task.y.o autoload module
task.y.o autoload CurrLib
sYmbol.AutoLoad.CHECK
sYmbol.AutoLoad.CHECK ON
)
ENDDO
