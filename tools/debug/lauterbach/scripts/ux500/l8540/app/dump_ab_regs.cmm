entry &FileName

if "&FileName"==""
(
	; use current script and replace .cmm by .txt
	&FileName=OS.PPF()
	&FileName=OS.FILE.NAME(&FileName)
	&FileName=string.cut("&FileName",-4)+".txt"
)

; update from AB8540 - Register Description Rev 1.0.11 / May 2012, 4th

; WARNING:
; for bank value, 0x20 is always added in abb_i2c_read and hwi2c.cmm
; for registers access from APP (as in AB9540) thus the value in script
; are not the same than in document

local &HWI2C
;&HWI2C=1.  ; I2C access with I2C
&HWI2C=0. ; I2C access with PRCMU mailbox

open #1 &FileName /Create
Write #1  "result of script " OS.PPF()
Write #1  clock.date() clock.time()
Write #1  ""
Write #1  "System Control ==================================="
Write #1  "System control1 / Status: Bank 0x01, Adr 00xxxxxx"
gosub READ_AB_VALUE 0x0100 TurnOnstatus
gosub READ_AB_VALUE 0x0101 Resetstatus
gosub READ_AB_VALUE 0x0102 PonKey1PressStatus
gosub READ_AB_VALUE 0x0103 SWControlFallback
gosub READ_AB_VALUE 0x0104 TurnOnStatus2
Write #1  "System control1 / System Clock Request: Bank 0x01, Adr 01xxxxxx"
gosub READ_AB_VALUE 0x0142 SysClkReqStatus
gosub READ_AB_VALUE 0x0150 Ctrldef0Spare0
gosub READ_AB_VALUE 0x0151 Ctrldef0Spare1
gosub READ_AB_VALUE 0x0152 Ctrldef0Spare2
gosub READ_AB_VALUE 0x0153 Ctrldef1Spare3
gosub READ_AB_VALUE 0x0154 Ctrlspare5fun
gosub READ_AB_VALUE 0x0157 Ctrlspare8fun
Write #1  "System control 1/ System Control registers: Bank 0x01, Adr 10xxxxxx"
gosub READ_AB_VALUE 0x0180 SystemCtrl1
gosub READ_AB_VALUE 0x0181 SystemCtrl2
gosub READ_AB_VALUE 0x0182 SystemCtrl4
gosub READ_AB_VALUE 0x0183 SystemCtrl5
gosub READ_AB_VALUE 0x0190 SysClkReq78Ctrl
Write #1  "System control 2"
gosub READ_AB_VALUE 0x0200 SystemCtrl3
gosub READ_AB_VALUE 0x0201 MainWDogCtrl
gosub READ_AB_VALUE 0x0202 MainWDogTimer
gosub READ_AB_VALUE 0x0203 LowBat
gosub READ_AB_VALUE 0x0204 BattOk
Write #1  "System control 2 / Clock control registers"
gosub READ_AB_VALUE 0x0205 SysClkTimer
gosub READ_AB_VALUE 0x0206 SmpsClkCtrl
gosub READ_AB_VALUE 0x0207 SmpsClkSel1
gosub READ_AB_VALUE 0x0208 SmpsClkSel2
gosub READ_AB_VALUE 0x0209 SmpsClkSel3
gosub READ_AB_VALUE 0x020A SysUlpClkConf
gosub READ_AB_VALUE 0x020B SysUlpClkCtrl1
gosub READ_AB_VALUE 0x020C SysClkCtrl
gosub READ_AB_VALUE 0x020D SysClkReq1Valid
gosub READ_AB_VALUE 0x020F SystemCtrlSpare
gosub READ_AB_VALUE 0x0210 SysClkReq1RfClkBuf
gosub READ_AB_VALUE 0x0211 SysClkReq2RfClkBuf
gosub READ_AB_VALUE 0x0212 SysClkReq3RfClkBuf
gosub READ_AB_VALUE 0x0213 SysClkReq4RfClkBuf
gosub READ_AB_VALUE 0x0214 SysClkReq5RfClkBuf
gosub READ_AB_VALUE 0x0215 SysClkReq6RfClkBuf
gosub READ_AB_VALUE 0x0216 SysClkReq7RfClkBuf
gosub READ_AB_VALUE 0x0217 SysClkReq8RfClkBuf
gosub READ_AB_VALUE 0x0220 DitherClkCtrl
gosub READ_AB_VALUE 0x0232 HiqClkCtrl
gosub READ_AB_VALUE 0x0233 VsimSysClkCtrl
gosub READ_AB_VALUE 0x0234 SysClk12BufCtrl
gosub READ_AB_VALUE 0x0235 SysClk12ConfCtrl
gosub READ_AB_VALUE 0x0236 SysClk12BufCtrl2
gosub READ_AB_VALUE 0x0237 SysClk12Buf1Valid
gosub READ_AB_VALUE 0x0238 SysClk12Buf2Valid
gosub READ_AB_VALUE 0x0239 SysClk12Buf3Valid
gosub READ_AB_VALUE 0x023A SysClk12Buf4Valid
gosub READ_AB_VALUE 0x023B SysClk12BufCtrl3
Write #1  "System control 2 / Battery control registers"
gosub READ_AB_VALUE 0x0240 RegsBattOkThF
gosub READ_AB_VALUE 0x0241 RegsBattOk1Sel
gosub READ_AB_VALUE 0x0242 RegsBattOk2Sel

Write #1  "Power Control======================================"
Write #1  "Regulator Control 1 / Bank 0x03 - Adr 0xxxxxxx"
gosub READ_AB_VALUE 0x0303 ReguRequestCtrl1
gosub READ_AB_VALUE 0x0304 ReguRequestCtrl2
gosub READ_AB_VALUE 0x0305 ReguRequestCtrl3
gosub READ_AB_VALUE 0x0306 ReguRequestCtrl4
gosub READ_AB_VALUE 0x0307 ReguSysClkReq1HPValid1
gosub READ_AB_VALUE 0x0308 ReguSysClkReq1HPValid2
gosub READ_AB_VALUE 0x0309 ReguHwHPReq1Valid1
gosub READ_AB_VALUE 0x030A ReguHwHPReq1Valid2
gosub READ_AB_VALUE 0x030B ReguHwHPReq2Valid1
gosub READ_AB_VALUE 0x030C ReguHwHPReq2Valid2
gosub READ_AB_VALUE 0x030D ReguSwHPReqValid1
gosub READ_AB_VALUE 0x030E ReguSwHPReqValid2
gosub READ_AB_VALUE 0x030F ReguSysClkReqValid1
gosub READ_AB_VALUE 0x0310 ReguSysClkReqValid2
gosub READ_AB_VALUE 0x0311 ReguVaux4ReqValid
gosub READ_AB_VALUE 0x0312 ReguVaux5ReqValid
gosub READ_AB_VALUE 0x0313 ReguVaux6ReqValid
gosub READ_AB_VALUE 0x0314 ReguVclkbReqValid
gosub READ_AB_VALUE 0x0315 ReguVrf1ReqValid
gosub READ_AB_VALUE 0x0320 MiscHWCtrl
Write #1  "Miscellaneous Regu control1 / Bank 0x03 - Adr 1xxxxxxx"
gosub READ_AB_VALUE 0x0380 ReguMisc1
gosub READ_AB_VALUE 0x0381 OTGSupplyCtrl
gosub READ_AB_VALUE 0x0382 VusbCtrl
gosub READ_AB_VALUE 0x0383 VaudioSupply
gosub READ_AB_VALUE 0x0384 ReguCtrl1Spare
gosub READ_AB_VALUE 0x0385 RegVintCore12HW
gosub READ_AB_VALUE 0x0387 VHSIC
gosub READ_AB_VALUE 0x0388 VSDIO
Write #1  "Regulator Control registers / Bank 0x04, Adr 00xxxxxx"
gosub READ_AB_VALUE 0x0400 ArmRegu1
gosub READ_AB_VALUE 0x0401 ArmRegu2
gosub READ_AB_VALUE 0x0402 VapeRegu
gosub READ_AB_VALUE 0x0403 Vsmps1Regu
gosub READ_AB_VALUE 0x0404 Vsmps2Regu
gosub READ_AB_VALUE 0x0405 Vsmps3Regu
gosub READ_AB_VALUE 0x0406 VpllVanaRegu
gosub READ_AB_VALUE 0x0408 ExtSupplyRegu
gosub READ_AB_VALUE 0x0409 Vaux12Regu
gosub READ_AB_VALUE 0x040A VRF1Vaux3Regu
gosub READ_AB_VALUE 0x040B VarmSel1
gosub READ_AB_VALUE 0x040C VarmSel2
gosub READ_AB_VALUE 0x040D VarmSel3
gosub READ_AB_VALUE 0x040E VapeSel1
gosub READ_AB_VALUE 0x040F VapeSel2
gosub READ_AB_VALUE 0x0410 VapeSel3
gosub READ_AB_VALUE 0x0411 VBBSel1
gosub READ_AB_VALUE 0x0412 VBBSel2
gosub READ_AB_VALUE 0x0413 Vsmps1Sel1
gosub READ_AB_VALUE 0x0414 Vsmps1Sel2
gosub READ_AB_VALUE 0x0415 Vsmps1Sel3
gosub READ_AB_VALUE 0x0417 Vsmps2Sel1
gosub READ_AB_VALUE 0x0418 Vsmps2Sel2
gosub READ_AB_VALUE 0x0419 Vsmps2Sel3
gosub READ_AB_VALUE 0x041B Vsmps3Sel1
gosub READ_AB_VALUE 0x041C Vsmps3Sel2
gosub READ_AB_VALUE 0x041D Vsmps3Sel3
gosub READ_AB_VALUE 0x041F Vaux1Sel
gosub READ_AB_VALUE 0x0420 Vaux2Sel
gosub READ_AB_VALUE 0x0421 VRF1Vaux3Sel
gosub READ_AB_VALUE 0x0422 ReguCtrlExtSup
gosub READ_AB_VALUE 0x0423 ModemCtrl2
gosub READ_AB_VALUE 0x0424 VarmSel4
gosub READ_AB_VALUE 0x0425 VarmSel5
gosub READ_AB_VALUE 0x0426 VarmSel6
gosub READ_AB_VALUE 0x0427 VarmSel7
gosub READ_AB_VALUE 0x0428 VarmSel4567Ctrl
gosub READ_AB_VALUE 0x0429 VanaVpllSel
gosub READ_AB_VALUE 0x042A VapeSel45Ctrl
gosub READ_AB_VALUE 0x042B VapeSel4
gosub READ_AB_VALUE 0x042C VapeSel5
gosub READ_AB_VALUE 0x042D Vaux4ReqCtrl
gosub READ_AB_VALUE 0x042E Vaux4Regu
gosub READ_AB_VALUE 0x042F Vaux4Sel
gosub READ_AB_VALUE 0x0431 Vaux5ReqCtrl
gosub READ_AB_VALUE 0x0432 Vaux5Regu
gosub READ_AB_VALUE 0x0433 Vaux5Sel
gosub READ_AB_VALUE 0x0434 Vaux6ReqCtrl
gosub READ_AB_VALUE 0x0435 Vaux6Regu
gosub READ_AB_VALUE 0x0436 Vaux6Sel
gosub READ_AB_VALUE 0x0437 VclkbReqCtrl
gosub READ_AB_VALUE 0x0438 VclkbRegu
gosub READ_AB_VALUE 0x0439 VclkbSel
gosub READ_AB_VALUE 0x0443 ReguCtrlDisch
gosub READ_AB_VALUE 0x0444 ReguCtrlDisch2
gosub READ_AB_VALUE 0x0448 ReguCtrlDisCh3
gosub READ_AB_VALUE 0x0449 ReguCtrlDisCh4

Write #1  "USB registers======================================="
Write #1  "USB Control and ULPI: Bank 0x5, Adr 10xxxxxx"
gosub READ_AB_VALUE 0x0580 UsbLineStatus
gosub READ_AB_VALUE 0x0581 UsbLineCtrl1
gosub READ_AB_VALUE 0x0582 UsbLineCtrl2
gosub READ_AB_VALUE 0x0583 UsbLineCtrl3
gosub READ_AB_VALUE 0x0587 UsbOTGCtrl
gosub READ_AB_VALUE 0x0588 UsbOTGStatus
gosub READ_AB_VALUE 0x0589 UsbPHYStatus
gosub READ_AB_VALUE 0x058A UsbPhyCtrl
gosub READ_AB_VALUE 0x0591 UsbAdpProbeTimerCurrentL
gosub READ_AB_VALUE 0x0592 UsbAdpProbeTimerCurrentH
gosub READ_AB_VALUE 0x0593 UsbAdpCtrl
gosub READ_AB_VALUE 0x0594 UsbLinkStatus

Write #1  "Battery Communication Interface====================="
gosub READ_AB_VALUE 0x0700 DBIReg1
gosub READ_AB_VALUE 0x0701 DBIReg2
gosub READ_AB_VALUE 0x0702 ACIComR1
gosub READ_AB_VALUE 0x0703 ACIComR2
gosub READ_AB_VALUE 0x0704 ACIComR3
gosub READ_AB_VALUE 0x0705 ACITxDataR
gosub READ_AB_VALUE 0x0706 ACIRxDataR
gosub READ_AB_VALUE 0x0707 ACISPLR
gosub READ_AB_VALUE 0x0710 SEIReg1
gosub READ_AB_VALUE 0x0711 SEIReg2
gosub READ_AB_VALUE 0x0720 OWIReg1
gosub READ_AB_VALUE 0x0721 OWIReg2
gosub READ_AB_VALUE 0x0730 BIF_MAIN_CONTROL
gosub READ_AB_VALUE 0x0731 BIF_HIGH_CLOCK_DIV
gosub READ_AB_VALUE 0x0732 BIF_TRANSACTION
gosub READ_AB_VALUE 0x0733 BIF_WRITE_DATA_MSB
gosub READ_AB_VALUE 0x0734 BIF_WRITE_DATA_LSB
gosub READ_AB_VALUE 0x0735 BIF_READ_DATA
gosub READ_AB_VALUE 0x0736 BIF_READ_BURST_LENGTH
gosub READ_AB_VALUE 0x0737 BIF_READ_FIFO_STATUS
gosub READ_AB_VALUE 0x0738 BIF_STATUS_1
gosub READ_AB_VALUE 0x0739 BIF_STATUS_2
gosub READ_AB_VALUE 0x073A BIF_TIMING_SHORT_DURATION
gosub READ_AB_VALUE 0x073B BIF_TIMING_LONG_DURATION
gosub READ_AB_VALUE 0x073C BIF_TIMING_STOP_DURATION
gosub READ_AB_VALUE 0x073D BIF_TIMEOUT_RESP_DURATION
gosub READ_AB_VALUE 0x073E BIF_WAKE_UP_DURATION
gosub READ_AB_VALUE 0x073F BIF_TIMING_MISC
gosub READ_AB_VALUE 0x0740 BIF_DIRECT_BCL
gosub READ_AB_VALUE 0x0741 BIF_INTERRUPT
gosub READ_AB_VALUE 0x0742 BIF_FIFO_WATERMARK
gosub READ_AB_VALUE 0x0743 BIF_ANA_CONTROL

Write #1  "ECI: Bank 8, Adr 00xxxxxx==========="
gosub READ_AB_VALUE 0x0800 ECICtrlReg
gosub READ_AB_VALUE 0x0801 ECIHookLevel
gosub READ_AB_VALUE 0x0802 ECIDataOutReg
gosub READ_AB_VALUE 0x0803 ECIDataInReg

Write #1  "Accessory detection: Bank 8, Adr 10xxxxxx==========="
gosub READ_AB_VALUE 0x0880 AccDetectDb1Th
gosub READ_AB_VALUE 0x0881 AccDetect2Th
gosub READ_AB_VALUE 0x0882 AccDetectCtrl

Write #1  "GPADC APE: Bank 0x0A===================================="
gosub READ_AB_VALUE 0x0A00 GPADCCtrl1
gosub READ_AB_VALUE 0x0A01 GPADCCtrl2
gosub READ_AB_VALUE 0x0A04 GPADCStatus
gosub READ_AB_VALUE 0x0A05 GPADCSwDataL
gosub READ_AB_VALUE 0x0A06 GPADCSwDataH
gosub READ_AB_VALUE 0x0A09 GPADCSwData2L
gosub READ_AB_VALUE 0x0A0A GPADCSwData2H
gosub READ_AB_VALUE 0x0A10 APEAAx
gosub READ_AB_VALUE 0x0A11 APEAAt
gosub READ_AB_VALUE 0x0A12 APEAAm
gosub READ_AB_VALUE 0x0A13 APEAAah
gosub READ_AB_VALUE 0x0A14 APEAAal

Write #1  "Charger============================================"
Write #1  "Charger Status: Bank 0x0B, Adr 00xxxxxx"
gosub READ_AB_VALUE 0x0B00 MainChStatus
gosub READ_AB_VALUE 0x0B02 UsbChStatus1
gosub READ_AB_VALUE 0x0B03 UsbChStatus2
gosub READ_AB_VALUE 0x0B04 UsbChStatus3
gosub READ_AB_VALUE 0x0B05 ChargerStatus

Write #1  "Charger / Control: Bank 0x0B, Adr 01xxxxxx"
gosub READ_AB_VALUE 0x0B40 ChVoltLevel
gosub READ_AB_VALUE 0x0B41 ChVoltLevelMax
gosub READ_AB_VALUE 0x0B42 ChOutCurrLevel
gosub READ_AB_VALUE 0x0B43 ChOutCurrLevelMax
gosub READ_AB_VALUE 0x0B44 ChOutCurrLevelBtempLowMed
gosub READ_AB_VALUE 0x0B50 ChargWDTimer
gosub READ_AB_VALUE 0x0B51 ChargWDCtrl
gosub READ_AB_VALUE 0x0B52 BtempHighTh
gosub READ_AB_VALUE 0x0B53 LedIndicatorPwmCtrl
gosub READ_AB_VALUE 0x0B54 LedIndicatorPwmDuty
gosub READ_AB_VALUE 0x0B55 BattOVV
gosub READ_AB_VALUE 0x0B56 ChargerCtrl
gosub READ_AB_VALUE 0x0B57 CharLedBlinkCtrl
gosub READ_AB_VALUE 0x0B60 BatCtrlCurrentSource
gosub READ_AB_VALUE 0x0B70 ChPPCtrl

Write #1  "Charger control: Bank 0x0B, Adr 10xxxxxx"
gosub READ_AB_VALUE 0x0BA0 RegIDDetCtrl1
gosub READ_AB_VALUE 0x0BA1 RegIDDetCtrl2
gosub READ_AB_VALUE 0x0BA2 RegIDDetCtrl3
gosub READ_AB_VALUE 0x0BA3 RegIDDetCtrl4
gosub READ_AB_VALUE 0x0BA4 RegIDDetKeyLevel
gosub READ_AB_VALUE 0x0BA5 MissPressExp
gosub READ_AB_VALUE 0x0BA6 RegIDDetVth
gosub READ_AB_VALUE 0x0BA7 RegIDDetState
gosub READ_AB_VALUE 0x0BA9 RegCarKitTst
gosub READ_AB_VALUE 0x0BAF RegIdDetKeyDeglitch
gosub READ_AB_VALUE 0x0BB0 RegIdDetKeyTimer1
gosub READ_AB_VALUE 0x0BB1 RegIdDetKeyTimer2
gosub READ_AB_VALUE 0x0BB2 RegIdDetKeyTimer3


Write #1  "Charger /USB Control: Bank 0x0B, Adr 11xxxxxx"
gosub READ_AB_VALUE 0x0BC0 UsbChCtrl1
gosub READ_AB_VALUE 0x0BC1 UsbChCtrl2
gosub READ_AB_VALUE 0x0BC2 UsbChCurrLevel
gosub READ_AB_VALUE 0x0BC3 USBChInputCurrRamp
gosub READ_AB_VALUE 0x0BC4 Combo_ICVS
gosub READ_AB_VALUE 0x0BC5 USB_power_path_mode
gosub READ_AB_VALUE 0x0BC6 USB_power_path_charging
gosub READ_AB_VALUE 0x0BF5 UsbChOutCurLim

Write #1  "Gas gauge: Bank 0x0C================================"
gosub READ_AB_VALUE 0x0C00 CCCtrl
gosub READ_AB_VALUE 0x0C07 CCSampleConvL
gosub READ_AB_VALUE 0x0C08 CCSampleConvH
gosub READ_AB_VALUE 0x0C09 CCCounterAvgOffset
gosub READ_AB_VALUE 0x0C0A CCOffset
gosub READ_AB_VALUE 0x0C10 NconvAccu
gosub READ_AB_VALUE 0x0C11 NconvAccuCtrl
gosub READ_AB_VALUE 0x0C12 CC_NconvAccuLow
gosub READ_AB_VALUE 0x0C13 CC_NconvAccuMed
gosub READ_AB_VALUE 0x0C14 CC_NconvAccuHigh

Write #1  "Audio: Bank 0x0D ==================================="

Write #1  "General Power Up and Software reset"
gosub READ_AB_VALUE 0x0D00 PowerUp
gosub READ_AB_VALUE 0x0D01 AudSwReset
gosub READ_AB_VALUE 0x0D02 ADPathEna
gosub READ_AB_VALUE 0x0D03 DAPathEna
gosub READ_AB_VALUE 0x0D04 AnaConf1
gosub READ_AB_VALUE 0x0D05 AnaConf2
gosub READ_AB_VALUE 0x0D06 DigMicConf
gosub READ_AB_VALUE 0x0D07 AnaConf3
gosub READ_AB_VALUE 0x0D08 AnaConf4
gosub READ_AB_VALUE 0x0D09 DAPathConf
gosub READ_AB_VALUE 0x0D0A MuteConf
gosub READ_AB_VALUE 0x0D0B ShortCirConf
gosub READ_AB_VALUE 0x0D0C AnaConf5
gosub READ_AB_VALUE 0x0D0D EnvCPConf
gosub READ_AB_VALUE 0x0D0E SigEnvConf
gosub READ_AB_VALUE 0x0D0F PWMGenConf1
gosub READ_AB_VALUE 0x0D10 PWMGenConf2
gosub READ_AB_VALUE 0x0D11 PWMGenConf3
gosub READ_AB_VALUE 0x0D14 AnaGain1
gosub READ_AB_VALUE 0x0D15 AnaGain2
gosub READ_AB_VALUE 0x0D16 AnaGain3
gosub READ_AB_VALUE 0x0D17 AnaGain4
gosub READ_AB_VALUE 0x0D18 DigLinHsLGain
gosub READ_AB_VALUE 0x0D19 DigLinHsRGain
gosub READ_AB_VALUE 0x0D1A ADFiltConf
gosub READ_AB_VALUE 0x0D1B DigIFConf1
gosub READ_AB_VALUE 0x0D1C DigIFConf2
gosub READ_AB_VALUE 0x0D1D DigIFConf3
gosub READ_AB_VALUE 0x0D1E DigIFConf4

Write #1  "TDM Audio Interface slots assignment from AD path"
gosub READ_AB_VALUE 0x0D1F ADSlotSel1
gosub READ_AB_VALUE 0x0D20 ADSlotSel2
gosub READ_AB_VALUE 0x0D21 ADSlotSel3
gosub READ_AB_VALUE 0x0D22 ADSlotSel4
gosub READ_AB_VALUE 0x0D23 ADSlotSel5
gosub READ_AB_VALUE 0x0D24 ADSlotSel6
gosub READ_AB_VALUE 0x0D25 ADSlotSel7
gosub READ_AB_VALUE 0x0D26 ADSlotSel8
gosub READ_AB_VALUE 0x0D27 ADSlotSel9
gosub READ_AB_VALUE 0x0D28 ADSlotSel10
gosub READ_AB_VALUE 0x0D29 ADSlotSel11
gosub READ_AB_VALUE 0x0D2A ADSlotSel12
gosub READ_AB_VALUE 0x0D2B ADSlotSel13
gosub READ_AB_VALUE 0x0D2C ADSlotSel14
gosub READ_AB_VALUE 0x0D2D ADSlotSel15
gosub READ_AB_VALUE 0x0D2E ADSlotSel16
gosub READ_AB_VALUE 0x0D2F ADSlotHizCtrl1
gosub READ_AB_VALUE 0x0D30 ADSlotHizCtrl2
gosub READ_AB_VALUE 0x0D31 ADSlotHizCtrl3
gosub READ_AB_VALUE 0x0D32 ADSlotHizCtrl4

Write #1  "DA channels allocation from TDM Audio Interface slots"
gosub READ_AB_VALUE 0x0D33 DASlotConf1
gosub READ_AB_VALUE 0x0D34 DASlotConf2
gosub READ_AB_VALUE 0x0D35 DASlotConf3
gosub READ_AB_VALUE 0x0D36 DASlotConf4
gosub READ_AB_VALUE 0x0D37 DASlotConf5
gosub READ_AB_VALUE 0x0D38 DASlotConf6
gosub READ_AB_VALUE 0x0D39 DASlotConf7
gosub READ_AB_VALUE 0x0D3A DASlotConf8

Write #1  "Class-D EMI Control"
gosub READ_AB_VALUE 0x0D3B ClassDConf1

Write #1  "Dmic decimator filter"
gosub READ_AB_VALUE 0x0D3E DmicFiltConf

Write #1  "Digital Multiplexers configuration"
gosub READ_AB_VALUE 0x0D3F DigMultConf1
gosub READ_AB_VALUE 0x0D40 DigMultConf2

Write #1  "AD paths digital gains"
gosub READ_AB_VALUE 0x0D41 ADDigGain1
gosub READ_AB_VALUE 0x0D42 ADDigGain2
gosub READ_AB_VALUE 0x0D43 ADDigGain3
gosub READ_AB_VALUE 0x0D44 ADDigGain4
gosub READ_AB_VALUE 0x0D45 ADDigGain5
gosub READ_AB_VALUE 0x0D46 ADDigGain6


Write #1  "DA paths digital gains"
gosub READ_AB_VALUE 0x0D47 DADigGain1
gosub READ_AB_VALUE 0x0D48 DADigGain2
gosub READ_AB_VALUE 0x0D49 DADigGain3
gosub READ_AB_VALUE 0x0D4A DADigGain4
gosub READ_AB_VALUE 0x0D4B DADigGain5
gosub READ_AB_VALUE 0x0D4C DADigGain6

Write #1  "Loopbacks digital gains"
gosub READ_AB_VALUE 0x0D4D ADDigLoopGain1
gosub READ_AB_VALUE 0x0D4E ADDigLoopGain2

Write #1  "Output drivers digital gains"
gosub READ_AB_VALUE 0x0D4F HsLEarDigGain
gosub READ_AB_VALUE 0x0D50 HsRDigGain

Write #1  "Side tone FIRs gain"
gosub READ_AB_VALUE 0x0D51 SidFIRGain1
gosub READ_AB_VALUE 0x0D52 SidFIRGain2

Write #1  "Acoustical Noise Cancellation (ANC) Control"
gosub READ_AB_VALUE 0x0D53 ANCConf1
gosub READ_AB_VALUE 0x0D54 ANCConf2
gosub READ_AB_VALUE 0x0D55 ANCConf3
gosub READ_AB_VALUE 0x0D56 ANCConf4
gosub READ_AB_VALUE 0x0D57 ANCConf5
gosub READ_AB_VALUE 0x0D58 ANCConf6
gosub READ_AB_VALUE 0x0D59 ANCConf7
gosub READ_AB_VALUE 0x0D5A ANCConf8
gosub READ_AB_VALUE 0x0D5B ANCConf9
gosub READ_AB_VALUE 0x0D5C ANCConf10
gosub READ_AB_VALUE 0x0D5D ANCConf11
gosub READ_AB_VALUE 0x0D5E ANCConf12
gosub READ_AB_VALUE 0x0D5F ANCConf13
gosub READ_AB_VALUE 0x0D60 ANCConf14

Write #1  "Side-tone FIR Controls"
gosub READ_AB_VALUE 0x0D61 SidFIRAdr
gosub READ_AB_VALUE 0x0D62 SidFIRCoef1
gosub READ_AB_VALUE 0x0D63 SidFIRCoef2
gosub READ_AB_VALUE 0x0D64 SidFIRConf
gosub READ_AB_VALUE 0x0D65 AudIntMask1
gosub READ_AB_VALUE 0x0D66 AudIntSource1
gosub READ_AB_VALUE 0x0D67 AudIntMask2
gosub READ_AB_VALUE 0x0D68 AudIntSource2

Write #1  "Burst FIFO Control"
gosub READ_AB_VALUE 0x0D69 FIFOConf1
gosub READ_AB_VALUE 0x0D6A FIFOConf2
gosub READ_AB_VALUE 0x0D6B FIFOConf3
gosub READ_AB_VALUE 0x0D6C FIFOConf4
gosub READ_AB_VALUE 0x0D6D FIFOConf5
gosub READ_AB_VALUE 0x0D6E FIFOConf6

Write #1  "Audio module revision"
gosub READ_AB_VALUE 0x0D6F AudRev

Write #1  "External Microphones and Drivers Control"
gosub READ_AB_VALUE 0x0D70 EPWM1Conf
gosub READ_AB_VALUE 0x0D71 EPWM2Conf
gosub READ_AB_VALUE 0x0D72 DmicFreq
gosub READ_AB_VALUE 0x0D73 UsbHsGain
gosub READ_AB_VALUE 0x0D74 UsbDrvCtrl
gosub READ_AB_VALUE 0x0D75 EarGainMicSel
gosub READ_AB_VALUE 0x0D76 PDMCtrl

Write #1  "Class-D Driver Control"
gosub READ_AB_VALUE 0x0D77 ClDEmiCtrl
gosub READ_AB_VALUE 0x0D78 HFGainCtrl
gosub READ_AB_VALUE 0x0D79 VibGainCtrl
gosub READ_AB_VALUE 0x0D7A
gosub READ_AB_VALUE 0x0D7B
gosub READ_AB_VALUE 0x0D7C
gosub READ_AB_VALUE 0x0D7D
gosub READ_AB_VALUE 0x0D7E
gosub READ_AB_VALUE 0x0D7F

Write #1  "Interrupt: Bank 0x0E ==============================="
gosub READ_AB_VALUE 0x0E00 ITSource1
gosub READ_AB_VALUE 0x0E01 ITSource2
gosub READ_AB_VALUE 0x0E02 ITSource3
gosub READ_AB_VALUE 0x0E03 ITSource4
gosub READ_AB_VALUE 0x0E04 ITSource5
gosub READ_AB_VALUE 0x0E05 ITSource6
gosub READ_AB_VALUE 0x0E0C ITSource13
gosub READ_AB_VALUE 0x0E0D ITSource14
gosub READ_AB_VALUE 0x0E12 ITSource19
gosub READ_AB_VALUE 0x0E13 ITSource20
gosub READ_AB_VALUE 0x0E14 ITSource21
gosub READ_AB_VALUE 0x0E15 ITSource22
gosub READ_AB_VALUE 0x0E16 ITSource23
gosub READ_AB_VALUE 0x0E17 ITSource24
gosub READ_AB_VALUE 0x0E18 ITSource25
gosub READ_AB_VALUE 0x0E19 ITSource26
gosub READ_AB_VALUE 0x0E1A ITSource27
gosub READ_AB_VALUE 0x0E1B ITSource28
gosub READ_AB_VALUE 0x0E1C ITSource29
gosub READ_AB_VALUE 0x0E1D ITSource30
gosub READ_AB_VALUE 0x0E1E ITSource31
gosub READ_AB_VALUE 0x0E1F ITSource32
gosub READ_AB_VALUE 0x0E20 ITLatch1
gosub READ_AB_VALUE 0x0E21 ITLatch2
gosub READ_AB_VALUE 0x0E22 ITLatch3
gosub READ_AB_VALUE 0x0E23 ITLatch4
gosub READ_AB_VALUE 0x0E24 ITLatch5
gosub READ_AB_VALUE 0x0E25 ITLatch6
gosub READ_AB_VALUE 0x0E2B ITLatch12
gosub READ_AB_VALUE 0x0E2C ITLatch13
gosub READ_AB_VALUE 0x0E2D ITLatch14
gosub READ_AB_VALUE 0x0E32 ITLatch19
gosub READ_AB_VALUE 0x0E33 ITLatch20
gosub READ_AB_VALUE 0x0E34 ITLatch21
gosub READ_AB_VALUE 0x0E35 ITLatch22
gosub READ_AB_VALUE 0x0E36 ITLatch23
gosub READ_AB_VALUE 0x0E37 ITLatch24
gosub READ_AB_VALUE 0x0E38 ITLatch25
gosub READ_AB_VALUE 0x0E39 ITLatch26
gosub READ_AB_VALUE 0x0E3A ITLatch27
gosub READ_AB_VALUE 0x0E3B ITLatch28
gosub READ_AB_VALUE 0x0E3C ITLatch29
gosub READ_AB_VALUE 0x0E3D ITLatch30
gosub READ_AB_VALUE 0x0E3E ITLatch31
gosub READ_AB_VALUE 0x0E3F ITLatch32
gosub READ_AB_VALUE 0x0E40 ITMask1
gosub READ_AB_VALUE 0x0E41 ITMask2
gosub READ_AB_VALUE 0x0E42 ITMask3
gosub READ_AB_VALUE 0x0E43 ITMask4
gosub READ_AB_VALUE 0x0E44 ITMask5
gosub READ_AB_VALUE 0x0E45 ITMask6
gosub READ_AB_VALUE 0x0E4B ITMask12
gosub READ_AB_VALUE 0x0E4C ITMask13
gosub READ_AB_VALUE 0x0E4D ITMask14
gosub READ_AB_VALUE 0x0E32 ITMask19
gosub READ_AB_VALUE 0x0E33 ITMask20
gosub READ_AB_VALUE 0x0E34 ITMask21
gosub READ_AB_VALUE 0x0E35 ITMask22
gosub READ_AB_VALUE 0x0E36 ITMask23
gosub READ_AB_VALUE 0x0E37 ITMask24
gosub READ_AB_VALUE 0x0E38 ITMask25
gosub READ_AB_VALUE 0x0E39 ITMask26
gosub READ_AB_VALUE 0x0E3A ITMask27
gosub READ_AB_VALUE 0x0E3B ITMask28
gosub READ_AB_VALUE 0x0E3C ITMask29
gosub READ_AB_VALUE 0x0E3D ITMask30
gosub READ_AB_VALUE 0x0E3E ITMask31
gosub READ_AB_VALUE 0x0E3F ITMask32
gosub READ_AB_VALUE 0x0E60 ITLatchHier1
gosub READ_AB_VALUE 0x0E61 ITLatchHier2
gosub READ_AB_VALUE 0x0E62 ITLatchHier3
gosub READ_AB_VALUE 0x0E63 ITLatchHier4

Write #1  "RTC: Bank 0xF======================================="
gosub READ_AB_VALUE 0x0F00 SwitchOffStatus
gosub READ_AB_VALUE 0x0F01 CCConf
gosub READ_AB_VALUE 0x0F02 RTCReadRequest
gosub READ_AB_VALUE 0x0F03 WatchtimeSecMid
gosub READ_AB_VALUE 0x0F04 WatchtimeSecHigh
gosub READ_AB_VALUE 0x0F05 WatchtimeMinLow
gosub READ_AB_VALUE 0x0F06 WatchtimeMinMid
gosub READ_AB_VALUE 0x0F07 WatchtimeMinHigh
gosub READ_AB_VALUE 0x0F08 AlarmMinLow
gosub READ_AB_VALUE 0x0F09 AlarmMinMid
gosub READ_AB_VALUE 0x0F0A AlarmMinHigh
gosub READ_AB_VALUE 0x0F0B RtcCtrl
gosub READ_AB_VALUE 0x0F0C RtcBackupChg
gosub READ_AB_VALUE 0x0F0D RtcForceBackup
gosub READ_AB_VALUE 0x0F0E RtcCalibration
gosub READ_AB_VALUE 0x0F0F RtcSwitchStatus
gosub READ_AB_VALUE 0x0F10 RtcRestartXtal32k
gosub READ_AB_VALUE 0x0F11 RtcCtrlSpare1Fun
gosub READ_AB_VALUE 0x0F12 PcutCtlAndStatus
gosub READ_AB_VALUE 0x0F13 PcutCutTime
gosub READ_AB_VALUE 0x0F14 PcutMaxTime
gosub READ_AB_VALUE 0x0F15 PcutFlagTime
gosub READ_AB_VALUE 0x0F16 PcutRestart
gosub READ_AB_VALUE 0x0F17 PcutDebounce
Write #1  "Miscellaneous:Bank 0x10============================="
Write #1  "General Purpose IO"
gosub READ_AB_VALUE 0x1000 GpioSel1
gosub READ_AB_VALUE 0x1001 GpioSel2
gosub READ_AB_VALUE 0x1002 GpioSel3
gosub READ_AB_VALUE 0x1003 GpioSel4
gosub READ_AB_VALUE 0x1004 GpioSel5
gosub READ_AB_VALUE 0x1005 GpioSel6
gosub READ_AB_VALUE 0x1006 GpioSel7
gosub READ_AB_VALUE 0x1010 GpioDir1
gosub READ_AB_VALUE 0x1011 GpioDir2
gosub READ_AB_VALUE 0x1012 GpioDir3
gosub READ_AB_VALUE 0x1013 GpioDir4
gosub READ_AB_VALUE 0x1014 GpioDir5
gosub READ_AB_VALUE 0x1015 GpioDir6
gosub READ_AB_VALUE 0x1016 GpioDir7
gosub READ_AB_VALUE 0x1020 GpioOut1
gosub READ_AB_VALUE 0x1021 GpioOut2
gosub READ_AB_VALUE 0x1022 GpioOut3
gosub READ_AB_VALUE 0x1023 GpioOut4
gosub READ_AB_VALUE 0x1024 GpioOut5
gosub READ_AB_VALUE 0x1025 GpioOut6
gosub READ_AB_VALUE 0x1026 GpioOut7
gosub READ_AB_VALUE 0x1030 GpioPud1
gosub READ_AB_VALUE 0x1031 GpioPud2
gosub READ_AB_VALUE 0x1032 GpioPud3
gosub READ_AB_VALUE 0x1033 GpioPud4
gosub READ_AB_VALUE 0x1034 GpioPud5
gosub READ_AB_VALUE 0x1035 GpioPud6
gosub READ_AB_VALUE 0x1036 GpioPud7
gosub READ_AB_VALUE 0x1040 GpioIn1
gosub READ_AB_VALUE 0x1041 GpioIn2
gosub READ_AB_VALUE 0x1042 GpioIn3
gosub READ_AB_VALUE 0x1043 GpioIn4
gosub READ_AB_VALUE 0x1044 GpioIn5
gosub READ_AB_VALUE 0x1045 GpioIn6
gosub READ_AB_VALUE 0x1046 GpioIn7
gosub READ_AB_VALUE 0x1047 GpioVinSel
gosub READ_AB_VALUE 0x1048 GpioPullUpDownSel
gosub READ_AB_VALUE 0x1049 KeyPressConf

Write #1  "Alternate function, PWM and I2C control"
gosub READ_AB_VALUE 0x1050 AlternatFunction
gosub READ_AB_VALUE 0x1060 PWMOutCtrl1
gosub READ_AB_VALUE 0x1061 PWMOutCtrl2
gosub READ_AB_VALUE 0x1062 PWMOutCtrl3
gosub READ_AB_VALUE 0x1063 PWMOutCtrl4
gosub READ_AB_VALUE 0x1064 PWMOutCtrl5
gosub READ_AB_VALUE 0x1065 PWMOutCtrl6
gosub READ_AB_VALUE 0x1066 PWMOutCtrl7
gosub READ_AB_VALUE 0x1067 I2CPadCtrl
gosub READ_AB_VALUE 0x1068 PWMOut1BlinkCtrl
gosub READ_AB_VALUE 0x1069 PWMOut2BlinkCtrl
gosub READ_AB_VALUE 0x106A PWMOut3BlinkCtrl
gosub READ_AB_VALUE 0x106B PWMOut4BlinkCtrl
gosub READ_AB_VALUE 0x1070 PWMOut1CurrCtrl
gosub READ_AB_VALUE 0x1071 PWMOut2CurrCtrl
gosub READ_AB_VALUE 0x1072 PWMOut3CurrCtrl
gosub READ_AB_VALUE 0x1073 PWMOutKPBCurrCtrl
gosub READ_AB_VALUE 0x1074 PWMOutMiscCurrCtrl

Write #1  "Chip identification"
gosub READ_AB_VALUE 0x1080 ChipRevision
gosub READ_AB_VALUE 0x1081 Chip
gosub READ_AB_VALUE 0x1082 ChipName

Write #1  "Test Mode and Status=============================="
Write #1  "Debug Test Mode Configuration"
gosub READ_AB_VALUE 0x1100 TestModeReg
gosub READ_AB_VALUE 0x1101 RegAccessCtrl
gosub READ_AB_VALUE 0x1105 NoAccessSupReg

Write #1  "FSM Status read back"
gosub READ_AB_VALUE 0x1106 FsmStatus1
gosub READ_AB_VALUE 0x1110 ChargerFsmStatus1
gosub READ_AB_VALUE 0x1111 ChargerFsmStatus2
gosub READ_AB_VALUE 0x1112 ChargerFsmStatus3
gosub READ_AB_VALUE 0x1113 ChargerFsmStatus4
gosub READ_AB_VALUE 0x1114 ChargerFsmStatus5
gosub READ_AB_VALUE 0x1115 ChargerFsmStatus6
gosub READ_AB_VALUE 0x1116 ChargerFsmStatus7
gosub READ_AB_VALUE 0x1117 ChargerFsmStatus8
gosub READ_AB_VALUE 0x1118 ChargerFsmStatus9
gosub READ_AB_VALUE 0x1119 ChargerFsmStatus10
gosub READ_AB_VALUE 0x111A ChargerFsmStatus11
gosub READ_AB_VALUE 0x111B ChargerFsmStatus12
gosub READ_AB_VALUE 0x111C ChargerFsmStatus13
gosub READ_AB_VALUE 0x111D ChargerFsmStatus14
gosub READ_AB_VALUE 0x111E ChargerFsmStatus15
gosub READ_AB_VALUE 0x111F ChargerFsmStatus16
gosub READ_AB_VALUE 0x1120 ChargerFsmStatus17
gosub READ_AB_VALUE 0x1121 ChargerFsmStatus18
gosub READ_AB_VALUE 0x1130 UsbAdpFsmStatus

Write #1  "Debug :Bank 12 registers=========================="
gosub READ_AB_VALUE 0x1201 DebugSpare1
gosub READ_AB_VALUE 0x1202 DebugSpare2
gosub READ_AB_VALUE 0x1203 DebugUsbStatus
gosub READ_AB_VALUE 0x1204 DebugUsbReg4
gosub READ_AB_VALUE 0x1205 DebugUsbReg6
gosub READ_AB_VALUE 0x1206 DebugUsbReg7
gosub READ_AB_VALUE 0x1207 DebugUsbReg8
gosub READ_AB_VALUE 0x1208 CurrentGaugeTestReg1
gosub READ_AB_VALUE 0x1209 PBTCHCTRL
gosub READ_AB_VALUE 0x120A DebugUsbAdp
gosub READ_AB_VALUE 0x120B DebugUsbAdp2
gosub READ_AB_VALUE 0x120C DebugVarmRegu
gosub READ_AB_VALUE 0x120D DebugVmodRegu
gosub READ_AB_VALUE 0x120E DebugVapeRegu
gosub READ_AB_VALUE 0x120F DebugVsmpsXRegu
gosub READ_AB_VALUE 0x1212 DebugVRF2Regu
gosub READ_AB_VALUE 0x1213 DebugVrftxRegu
gosub READ_AB_VALUE 0x1280 DebugRtc


close #1
print "&FileName file saved !"
enddo

READ_AB_VALUE:
	entry &Reg_Address &Reg_Name

global &ValueToRead
if "&HWI2C"=="1."
(
  global &dataRead
  &abb_bank=&Reg_Address>>8.
  &abb_address=&Reg_Address&0xFF
  do hwi2c.cmm &abb_bank &abb_address 0x0 1.
  ; reformat data depending to abxxxx hwi2c protocol
  &ValueToRead=(&dataRead>>24.)&0xFF
)
else
(
  do abb_i2c_read &Reg_Address
)
print "&Reg_Address : &ValueToRead	&Reg_Name "
Write #1  "&Reg_Address : &ValueToRead	&Reg_Name "
return


