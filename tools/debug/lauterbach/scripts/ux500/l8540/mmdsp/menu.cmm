;------------------------------------------------------------
; menu.cmm
;------------------------------------------------------------
; Create target specific menu
;
; 110620 - KM Initial version
;-----------------------------------------------------------


enddo