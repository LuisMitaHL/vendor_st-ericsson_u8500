;------------------------------------------------------------
; load_dual.cmm
;------------------------------------------------------------
; Startup file to select and setup target
;
; 091207 - KM Initial version
;-----------------------------------------------------------
; This file set up all cores
;-----------------------------------------------------------

; Since this is a SMP configuration we only have one instance of TRACE32, just call load_target

do load_target.cmm

ENDDO
