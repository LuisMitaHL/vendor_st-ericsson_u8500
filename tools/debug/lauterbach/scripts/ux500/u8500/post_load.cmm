;------------------------------------------------------------
; post_load.cmm
;------------------------------------------------------------
; Should include commands that must run after load
;
; 091207 - KM Initial version
;
;-----------------------------------------------------------



break.enable		;Enable breakpoint after sys.up

ENDDO