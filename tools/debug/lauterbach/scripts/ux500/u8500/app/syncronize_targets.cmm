;------------------------------------------------------------
; syncronize_targets.cmm
;------------------------------------------------------------

;
; 090508 - KM Initial version
;-----------------------------------------------------------

// Prepare for syncronize debuggers





 ENDDO
