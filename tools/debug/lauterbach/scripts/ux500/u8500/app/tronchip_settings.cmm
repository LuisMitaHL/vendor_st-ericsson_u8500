;------------------------------------------------------------
; tronchip_settings.cmm
;------------------------------------------------------------
; Setup catch vector, must be called before sys.mode attach
;
; 110526 - KM Initial version
; 111019 - PDE adapt for 9540
;-----------------------------------------------------------

TrOnchip.Set DABORT OFF; used by Linux for page miss!
TrOnchip.Set PABORT OFF        ; used by Linux for page miss!
TrOnchip.Set UNDEF OFF       ; used by Linux for the
TrOnchip.Set StepVector OFF        ; used by Linux for the
TrOnchip.Set SWI OFF        ; used by Linux for the

enddo
