//============================================================================
// Lauterbach T32 Emulator script: stm_sampling_stop.cmm
//============================================================================
print "Stop STP acquisition"
; Unload all loaded DLLs
ca.off
ca.pproto
ca.write
ca.PipeWRITE

