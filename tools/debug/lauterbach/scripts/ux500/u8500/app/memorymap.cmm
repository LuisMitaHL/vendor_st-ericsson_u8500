;------------------------------------------------------------
; memorymap.cmm
;------------------------------------------------------------
; define memory map 
;
; 091207 - KM Initial version
;-----------------------------------------------------------

;Enable possabillity to add arguments to the cmm file
ENTRY &arg1 &arg2 &arg3 &arg4 &arg5 &arg6 &arg7 &arg8
screen.off


screen

IF "&arg1"==""
  enddo

&arg1 &arg2 &arg3 &arg4 &arg5 &arg6 &arg7 &arg8

ENDDO