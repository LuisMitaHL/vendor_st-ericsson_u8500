entry &val

if "&chip_version"!="v2"
(
	print "Cannot run this script with this chip version"
	enddo
)

if run()
(
	dialog.yesno "Stop the execution to dump registers?"
	entry &yn
	if &yn
		break
	else
		enddo
)

local &filename
dialog.filew *
entry %line &filename
if "&filename"!=""
(
	if "&val"=="ALL"
	(
		do dump_all_regs "&filename"
	)
	else if "&val"=="AB8500"
	(
		do dump_ab8500_regs "&filename"
	)
	print "&filename saved"
)
enddo
