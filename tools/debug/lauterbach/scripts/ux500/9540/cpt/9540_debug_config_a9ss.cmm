; #####################################################################
; # AP9540 debug & Trace script file: 9540_debug_config_a9ss.cmm      #
; # Copyright (C) 2011, STMicroelectronics. All Rights Reserved       #
; #####################################################################
; This script is used for Trace32 debug configuration on 9540.
; Crated by HED/CSP/CPT/ACT on 2009-03-31
; Contact jingyi-xiaoyan.lu@st.com
; 2010-11-03: initial version.
; 2011-03-9: reworked.
; 2011-05-20: added security check (SECSTS1).
; 2011-10-02: added testmode setting. PORn is asserted/deasserted in this version; to check the impact on the attach mode!!
; 2011-11-16: fix for multi-gui debug. some clean-up. JTAG frequency ajustment for combiprobe.
; 2012-01-05: fix the crash of debugPortCfg and intercom when raw jtag injection is used.
; 2012-04-04: added "jc", "dbgboot" and "waitboot" options
; 2012-06-11: added "dis_cflush" option.
;		fixed: "IDCODE detection failure does not cause endless loop"
;		timeout issue with slow platform: palladium

local &cur_dir &sxa &prcmu &connection_mode &cjtag2pin &dbg_thr_reset &pwrdwn &secsts1 &dbgboot &waitboot &jc
local &inv_dbg0_permitted &inv_dbg1_permitted &inv_dbg_permitted &corebase0 &corebase1 &dis_cflush
local &idcode_v &por_toggled &testmode_v
&cur_dir=os.ppd()
ENTRY &9540_ver &platform &dbg_config &core &debug_stop_the_other_core

;--- handle the parameters
gosub HandleParameters

;--- Resets all parameters to their original position
if &cjtag2pin!=1
	sys.reset

;--- configure the debug port type
do "&cur_dir/debugPortCfg" &cjtag2pin

;--- jtag clock
gosub SetJtagClockFreq

;--- dbgboot, IDCODE and top permission check
gosub jtag_stuffs

;--- cpu setting
gosub SetCpuName

;--- configure TAPs topology and the TAP position
gosub ScanChainCfg

; --- disable all vector/exception halt
gosub DisableVectorHalts

;--- configure the CS components bases addresses
gosub SetCSBaseAddrs

; --- read the security configuration and the core(s) state(s)
&cjtag2pin_retry=0
&in_lab2=0
&in_lab4=0
&break_done_by_lab=0
prepare:
gosub SecurityCoreStateCheck

;--- connection
connection:
gosub DoConnection

; --- in case of cjtag2pin, once the connection is successfully done, change the JC to 15Mhz
if &cjtag2pin==1&&system.up()&&"&platform"!="PALLADIUM"
	sys.jc ctck 30mhz

;--- AMP mode only: force the other core to enter the debug mode
gosub ForceOtherCoreHalt

enddo (0==0)







; =================== Sub Functions ===================

lab1:
	if system.usecore()<=1
		gosub checkSecurityOnError
	if system.up()&&&default==1
			DIALOG.OK "Error in SoC config after SYS.UP!"
	else
	(
		if &cjtag2pin_retry==0&&&cjtag2pin==1&&"&core"!="CPU1" // the current mode is perhaps in JTAG mode, change to cjtag
		(
			print "The current mode is perhaps JTAG. Try to change to cJTAG firstly and reconfigure the 2Pin mode..."
			// try with 4pin mode
			&cjtag2pin=0
			do "&cur_dir/debugPortCfg" &cjtag2pin
			&cjtag2pin=1
			sys.o.pwrcheck off
			sys.up
			if system.up() //redo the dbgcfg this time with debugger connected, so that it can change to cjtag mode.
			(
				do "&cur_dir/jtagcjtag"
				do "&cur_dir/debugPortCfg" &cjtag2pin
				&cjtag2pin_retry=1
				goto connection
			)
		)
		if !system.up()
			DIALOG.OK "SYS.UP FAILED"
	)
	enddo (1==0)

lab2:
	if &cjtag2pin_retry==0&&&cjtag2pin==1&&"&core"!="CPU1" // the current mode is perhaps in JTAG mode, change cjtag
	(
		print "The current mode is perhaps JTAG. Try to change to cJTAG firstly and reconfigure the 2Pin mode..."
		// try with 4pin mode
		sys.down
		&cjtag2pin=0
		do "&cur_dir/debugPortCfg" &cjtag2pin
		&cjtag2pin=1
		sys.o.enreset off
		sys.o.resbreak off
		if "&connection_mode"=="up"
			sys.up
		else
			sys.m.attach
		if system.up() //redo the dbgcfg this time with debugger connected, so that it can change to cjtag mode.
		(
			if run()
			(
			     &break_done_by_lab=1
			     break
			)
			do "&cur_dir/jtagcjtag"
			do "&cur_dir/debugPortCfg" &cjtag2pin
			&cjtag2pin_retry=1
			&in_lab2=1
			goto prepare
		)
	 )
	 else
	 (
		DIALOG.OK "Read APB memory failed!"
		enddo (1==0)
	 )

lab4:
	if system.usecore()<=1
	(
		gosub checkSecurityOnError

		//if &mod==1&&(&soc_mod==0||(&soc_mod==1&&&run_debug_config_nb==2))&&(&secsts1>>1&1)==0
		//(
		//	dialog.ok "The Modem debug is disabled by the security control logic. Cannot include MOD-DAP!"
		//	enddo (1==0)
		//)

		if &cjtag2pin_retry==0&&&cjtag2pin==1 // the current mode is perhaps in JTAG mode, change cjtag
		(
			print "The current mode is perhaps JTAG. Try to change to cJTAG firstly and reconfigure the 2Pin mode..."
		        // try with 4pin mode
			sys.down
			&cjtag2pin=0
			do "&cur_dir/debugPortCfg" &cjtag2pin
			&cjtag2pin=1
			sys.o.enreset off
			sys.o.resbreak off
			sys.up
			if system.up() //redo the dbgcfg this time with debugger connected, so that it can change to cjtag mode.
			(
				if run()
				(
					&break_done_by_lab=1
					break
				)
				do "&cur_dir/jtagcjtag"
				do "&cur_dir/debugPortCfg" &cjtag2pin
				&cjtag2pin_retry=1
				&in_lab4=1
				goto prepare
			)
		)
	)

	DIALOG.OK "first connection SYS.M.PREPARE/ATTACH failed!"
	enddo (1==0)

lab5:
	DIALOG.OK "SYS.M.ATTACH failed!"
	enddo (1==0)


ScanChainCfg:
	; --- configure the TAPs topology and the TAP position
	if system.up()
		sys.down
	print "Configuring the scan chain topology for 9540 ..."
	&cfg_connect_val=0xCF
	if &prcmu==1
		&cfg_connect_val=&cfg_connect_val&~0x03
	if &sxa==1
		&cfg_connect_val=&cfg_connect_val&~0x0C
	sys.config.cfgconnect &cfg_connect_val
	print "DONE."
	return


HandleParameters:
	;---- transform all parameter to uppercase
	&9540_ver=string.upr("&9540_ver")
	&platform=string.upr("&platform")
	&core=string.upr("&core")
	&debug_stop_the_other_core=string.upr("&debug_stop_the_other_core")

	;---- extract the dbg_config parameters
	&connection_mode=""
	&cjtag2pin=0
	&mod=0
	&sxa=0
	&prcmu=0
	&dbg_thr_reset=0
	&pwrdwn=0
	&semihost=0
	&save_dbg_config="&dbg_config"
	&dbgboot=0
	&waitboot=""
	&dis_cflush=0
	while string.len("&dbg_config")!=0
	(
		&plus_idx=STRING.SCAN("&dbg_config","+",0)
		if &plus_idx==0
		(
			print "init_9540.cmm: Invalid parameter: &dbg_config !"
			enddo (1==0)
		)
		if &plus_idx==-1 // there is not any "+", i.e. &dbg_config contains only 1 word
			&plus_idx=string.len("&dbg_config")

		// extract the first parameter
		&temp=string.mid("&dbg_config",0,&plus_idx)
		&param=string.lwr("&temp")

		// check the extraited paramter's validity
		if "&param"!="attach"&&"&param"!="up"&&"&param"!="cjtag2pin"&&"&param"!="sxa"&&"&param"!="prcmu"&&"&param"!="dbg_thr_reset"&&"&param"!="pwrdwn"&&"&param"!="semihost"&&"&param"!="dbgboot"&&string.mid("&param",0,8)!="waitboot"&&string.mid("&param",0,2)!="jc"&&"&param"!="dis_cflush"
		(
			print "init_9540.cmm: Invalid configuration parameter: &temp !"
			enddo (1==0)
		)
		if string.mid("&param",0,8)=="waitboot"
			&waitboot=string.cut("&param",8)
		if string.mid("&param",0,2)=="jc"
			&jc=string.cut("&param",2)
		// if dbg_config contains several "up" or "attach" at a time, the last "up" or "attach" covers the previous ones.
		if "&param"=="up"||"&param"=="attach"
			&connection_mode="&param"
		else
			&&(param)=1


		// cut off the first parameter and the "+"
		&dbg_config=string.cut("&dbg_config",&plus_idx+1)
	)
	&dbg_config="&save_dbg_config"
	if "&connection_mode"==""
	(
		print "init_9540.cmm: ""up"" or ""attach"" is needed by the parameter ""dbg_config""!"
		enddo (1==0)
	)
	return

SetCpuName:
	&cpuname_prefix="DB"
	if version.build()>33343.
		&cpuname_prefix="A"
	if &smp==1
		sys.cpu &(cpuname_prefix)9540
	else if "&core"=="CPU0"
		sys.cpu &(cpuname_prefix)9540APE-CORE0
	else //CPU1
		sys.cpu &(cpuname_prefix)9540APE-CORE1
	return

SetJtagClockFreq:
	if combiprobe()
		sys.jc 25Mhz
	else
		sys.jc ctck 40Mhz
	if &cjtag2pin==1
		sys.jc ctck 30Mhz
	if "&platform"=="PALLADIUM"
	(
		sys.jc 50khz  //db_1x_try30
		sys.o.palladium on
	)
	if &cjtag2pin==1&&"&platform"=="PALLADIUM"
		sys.jc ctck 50Khz
	if &prcmu==1
		sys.jc ctck 20Mhz
	if "&jc"!=""
		sys.jc &jc
	return


SecurityCoreStateCheck:
	&inv_dbg0_permitted=1.
	&inv_dbg1_permitted=1.
	&inv_dbg_permitted=1.
	if &dbg_thr_reset!=1&&system.usecore()<=1
	(
		//////////////////////////////////////////////////////////////////
		// increase the value below if the boot needs bigger latency.
		//////////////////////////////////////////////////////////////////
// ----- to change later when the normal appli is flashed.
		&MAX_LOOP_TIMES=40000.

		on ERROR goto lab4
		sys.o.resbreak off
		if (&por_toggled==0&&&testmode_v==0)
		(
			sys.o.enreset on
			sys.o.waitreset &waitboot
		)
		else
		(
			sys.o.enreset off
			sys.o.waitreset off
		)
		sys.o.pwrcheck off
		// only the first instance drives the RESETn
		if system.usecore()>1||"&connection_mode"=="attach"||&in_lab2==1||&in_lab4==1
		(
			sys.o.enreset off
			sys.o.waitreset off
		)

		if "&connection_mode"=="up"
			sys.mode.prepare
		else
			sys.mode.attach
		if !system.up()
			goto lab4
		if &in_lab2==1
			&in_lab2=0
		if &in_lab4==1
			&in_lab4=0

		on ERROR goto lab2
		&inv_dbg0_permitted=0.
		&inv_dbg1_permitted=0.
		&inv_dbg_permitted=0.
		&ns_state0=d.l(EAPB:&corebase0+0x88)>>18.&1
		&ns_state1=d.l(EAPB:&corebase1+0x88)>>18.&1
		&print_security_state0=""
		&print_security_state1=""

		&remap=0
		if &ns_state0==0
		(
			print "Detected the board boots from FSMC."
			&remap=1
		)
		else
		(
			print "Detected the board boots from ROMCODE."
			&remap=0
		)

		; 2) --- determine whether the invasive debug is permitted
		&s_inv0=d.l(EAPB:&corebase0+0xFB8)>>4&1
		&s_inv1=d.l(EAPB:&corebase1+0xFB8)>>4&1
		if &s_inv0==1&&&s_inv1==1
		(
			print "Detected UNLOCKED chip."
			print "Invasive debugging is ENABLED."
			&inv_dbg_permitted=1
			&inv_dbg0_permitted=1.
			&inv_dbg1_permitted=1.
		)
		else
		(
			&locked_chip=1
			print "Detected LOCKED chip"
			if &remap==1  // bypass romcode
			(
				print "Invasive debugging is DISABLED! Check the remap setting on your board!"
				enddo (1==0)
			)

			; with romcode
			; we expect that the NS invasive debug is opened by romcode
			&loop=0
			while &inv_dbg_permitted==0&&&loop<10000.
			(
				&dbgen0=d.l(EAPB:&corebase0+0xFB8)&1
				&dbgen1=d.l(EAPB:&corebase1+0xFB8)&1

				if &smp==1.
					&inv_dbg_permitted=&dbgen0&&dbgen1
				else if string.upr("&core")=="CPU0"
					&inv_dbg_permitted=&dbgen0
				else
					&inv_dbg_permitted=&dbgen1

				&loop=&loop+1
			)

			print "After detecting debug permission (", %decimal &loop, " times):"
			if &inv_dbg_permitted==0
			(
			  print "Invasive debugging is DISABLED. Consequently you can not halt the core or change the current core state."
			  if &remap==0
				print "Your board is possibly NOT flashed!!!"
			)
			else
			  print "Invasive debugging is ENABLED in non-secure mode."
		)

		; 3) --- determine the end of the boot phase by the CPU1 state (non-secure is expected without normal_appli)
		; !!!! whether the board is flashed or not, we detect the CPU1 state to non-secure,
		; !!!! which penalize the case of non-flashed board booted with romcode
		if &remap==0&&&inv_dbg_permitted==1
		(
			&loop=0
			if "&connection_mode"=="up"&&&dbgboot==0
			(
				print "Waiting the end of boot (can be up to 30 seconds) ......"
				while &ns_state1==0&&&loop<&MAX_LOOP_TIMES
				(
					&ns_state1=d.l(EAPB:&corebase1+0x88)>>18.&1
					&loop=&loop+1
				)
			)
			else  //attach
				&ns_state1=d.l(EAPB:&corebase1+0x88)>>18.&1
			&ns_state0=d.l(EAPB:&corebase0+0x88)>>18.&1


			if "&connection_mode"=="up"
				print "After detecting CPU1 state (", %decimal &loop, " times):"
			if &ns_state0==0
				&print_security_state0="SECURE"
			else
				&print_security_state0="NON-SECURE"
			if &ns_state1==0
				&print_security_state1="SECURE"
			else
				&print_security_state1="NON-SECURE"

			if string.upr("&core")=="CPU0"||&smp==1
			   print "CPU0 is currently in &print_security_state0 mode."
			if string.upr("&core")=="CPU1"||&smp==1
			   print "CPU1 is currently in &print_security_state1 mode."
		)
	)
	on ERROR NOTHING
	return

SetCSBaseAddrs:
	&corebase0=0x801A8000
	&corebase1=0x801AA000
	&ctibase0=0x801AC000
	&ctibase1=0x801AD000
	if &smp==1
		sys.config.ctibase APB:&ctibase0 &ctibase1
	else if string.upr("&core")=="CPU0"
		sys.config.ctibase APB:&ctibase0
	else
		sys.config.ctibase APB:&ctibase1
	return

DoConnection:
	sys.o.pwrcheck on
	; allow the debug modify memory domain access permission
	sys.o.dacr on
	if &dis_cflush==1
		sys.o.cflush off
	if &dbg_thr_reset==1&&system.usecore()<=1  // debug through reset use case
	(
		if "&platform"=="CCU"
			print "debug through reset is not feasible on the CCU (locked) boards, please use ""dbgboot"" option instead!"
		else if &por_toggled==0&&&testmode_v==0
		(
			sys.o.resbreak on
			sys.o.enreset on
			sys.o.waitreset on
		)
	)
	else
	(
		sys.o.enreset off
		sys.o.resBreak off
		sys.o.waitReset off
	)

	if &pwrdwn==1
		sys.o.pwrdwn on
	else
		sys.o.pwrdwn off

	if "&connection_mode"=="up"
	(
		if system.up()
			sys.down
		on ERROR goto lab1
		if &inv_dbg_permitted==1
		(
			sys.up
			if system.up()
				print "SYS.UP OK!"
		)
		else
		(
			print "Attach to the target core ..."
			sys.m.attach
			if system.up()
				print "SYS.M.ATTACH OK!"
		)
		on ERROR NOTHING
	)
	else
	(
		if system.up()
			sys.down
		on ERROR goto lab5
		sys.m.attach
		if system.up()
			print "SYS.M.ATTACH OK!"
		if &break_done_by_lab==1
			go
		on ERROR NOTHING
	)
	return

ForceOtherCoreHalt:
	if &inv_dbg_permitted==1&&&smp==0&&string.upr("&debug_stop_the_other_core")=="Y"&&"&connection_mode"=="up"
	(
		&dscr_addr=0x801A8088
		&drcr_addr=0x801A8090
		&the_other_core="CPU1"
		&the_other_inv_dbg_permitted=&inv_dbg1_permitted
		if  string.upr("&core")=="CPU1"
		(
		  &dscr_addr=0x801AA088
		  &drcr_addr=0x801AA090
		  &the_other_core="CPU0"
		  &the_other_inv_dbg_permitted=&inv_dbg0_permitted
		)

		if &the_other_inv_dbg_permitted==1
		(
		  data.set EAPB:&drcr_addr %long d.l(EAPB:&drcr_addr)|0x1
		  &loop=1
		  while (d.l(EAPB:&dscr_addr)&0x1)!=0x1&&&loop<100.
		  (
		   &loop=&loop+1
		  )
		  if &loop>=100.
		  (
		   print "Warning: Failed to make the &the_other_core enter in debug state!"
		  )
		)
	)
	return

DisableVectorHalts:
	tronchip.set undef off
	tronchip.set pabort off
	tronchip.set dabort off
	tronchip.set reset off
	tronchip.set swi off
	return


ReadSecSts:
	&secsts1=0
	jtag.shifttms 1 0 0
	jtag.shiftreg 0 1 0 1 1 1
	jtag.shifttms 1 0 0 1 0 0
	jtag.shiftreg 0 0 1 0
	jtag.shifttms 1 0 0 1 0 0
	jtag.shiftreg %s 0
	&secsts1=jtag.shift()
	jtag.shifttms 1 0 0 1
	//print "secsts1 = 0x",%HEX &secsts1
	return


toggleTRSTn:
	jtag.pin NTRST 0
	jtag.pin NTRST 1
	return

readIDCODE:
	jtag.shifttms 0 1 0 0
	jtag.shiftreg %l 0
	&idcode_v=jtag.shift()
	jtag.shifttms 1 0 0 1
	//print "IDCODE = 0x", %HEX &idcode_v
	return

write_CLTAP_reg:
	jtag.shifttms 1 0 0
	jtag.shiftreg 0 1 0 1 1 1
	jtag.shifttms 1 0 0 1 0 0
	jtag.shiftreg 1 1 0 0
	jtag.shifttms 1 0 0 1 0 0
	jtag.shiftreg %s 0x20
	jtag.shifttms 1 0 0 1
	return


checkSecurityOnError:
		if (&secsts1>>2&1)==0  //TOPAPEDBGEN
		(
			dialog.ok "The APE debug is disabled by the security control logic."
			enddo (1==0)
		)
		if &prcmu==1&&(&secsts1>>3&1)==0
		(
			dialog.ok "The PRCMU debug is disabled by the security control logic. Cannot include PRCMU-TAP!"
			enddo (1==0)
		)
		return

jtag_stuffs:
	if system.usecore()<=1 // only the master debugger perform this.
	(
		if &dbgboot==1&&"&core"!="CPU0"
		(
			print "!! ERROR !!: the ""dbgboot"" option is only applicable to ""CPU0"". &core is selected => ""dbgboot"" is ignored!"
		)

		&idcode_v=0
		&secsts1=0
		&testmode_v=0
		if &dbgboot==1&&"&core"=="CPU0"
		(
			jtag.pin nreset 0
			jtag.pin nreset 1
			&por_toggled=1
			jtag.lock
			jtag.pin enable
			gosub toggleTRSTn
			&loop=0
			while &idcode_v!=0x82286041&&&loop<5000.
			(
				gosub readIDCODE
				&loop=&loop+1
			)
			if &loop>=5000.
				print "ERROR: Invalid IDCODE &idcode_v"

			&loop=0
			while (&secsts1>>8&1)!=1&&&loop<10000.
			(
				gosub ReadSecSts
				&loop=&loop+1
			)
			if &loop>=10000.
				print "WARNING: Debug is not permitted by the security control unit."

			gosub write_CLTAP_reg
			jtag.pin disable
			jtag.unlock
		)
		else
		(
			jtag.lock
			jtag.pin enable
			;--- check topdbgen
			gosub toggleTRSTn
			gosub readIDCODE
			if (&idcode_v==0xDEADBEEF)
			(
				print "Debug is disabled by the security!"
				enddo (1==0)
			)
			if (&idcode_v==0||(&idcode_v&0xFFFF)!=0x6041)
			(
				print "Invalid IDCODE: 0x", %HEX &idcode_v
				enddo (1==0)
			)

			;--- set Testmode if needed
			do "&cur_dir/Fuse_TestMode.cmm" 0 &dbg_thr_reset

			;--- read security status
			gosub ReadSecSts
			jtag.pin disable
			jtag.unlock
		)
	)
	return
