&mem_acc_prefix="eahb"

;STMAPE: 
;GPIO 23, 25-28 ALT-C1
//data.set &mem_acc_prefix:0x8012E020 %long 0x1E800000
//data.set &mem_acc_prefix:0x8012E024 %long 0x1E800000
//
//;GPIO 70-74 ALT-C
//data.set &mem_acc_prefix:0x8000E020  %long 0x000007C0 
//data.set &mem_acc_prefix:0x8000E024  %long 0x000007C0 

;GPIO 155-159 ALT-C
data.set &mem_acc_prefix:0x8000E120  %long 0xF8000000 
data.set &mem_acc_prefix:0x8000E124  %long 0xF8000000 

