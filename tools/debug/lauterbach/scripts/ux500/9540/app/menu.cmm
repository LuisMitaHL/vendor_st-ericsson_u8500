;------------------------------------------------------------
; menu.cmm
;------------------------------------------------------------
; Create target specific menu
;
; 101004 - KM Initial version
; 111011 - PDE 9540 adpatation
;-----------------------------------------------------------

menu.rp
(
	add
	menu
	(
		POPUP "9540"
		(
			menuitem "DB9540 peripherals (with tree)"
			(
				if ("&chip_version"=="")
				(
					do chip_version.cmm
				)
				per db9540_tree_&(chip_version).per
			)
			menuitem "DB9540 peripherals (flat)"
			(
				if ("&chip_version"=="")
				(
					do chip_version.cmm
				)
				per db9540_&(chip_version).per
			)
if os.file(~~/percltapdb9540.per)
(
			menuitem "DB9540 TAP peripherals"
			(
				per ~~/percltapdb9540.per
			)
)

			menuitem "Cortex-A9 peripherals"
			(
				per ~~/percortexa9mpcore.per

			)
			Separator
			popup "CoreSight"
			(
				; Perip4 = 0x80150000
				; + 0x5000 => A9 Debug peripheral
				menuitem "ETB"            "per etb.per 0x801A4000"
				menuitem "CTI Core 0"	  "per cti.per 0x801AC000"
				menuitem "CTI Core 1"	  "per cti.per 0x801AD000"
				menuitem "Trace Funnel"   "per trcfun.per 0x801A6000"
				menuitem "PTM Core 0"     "per etm.per 0x801AE000"
				menuitem "PTM Core 1"     "per etm.per 0x801AF000"
				; + 0x4000 => SoC TPIU
				menuitem "TPIU"           "per tpiu.per 0x80190000"
			)
			separator
			popup "Trace"
			(
				menuitem "Use PTM"
				(
					&EtmApp="True"
					do writesettings.cmm
					do etm_settings
				)
				menuitem "Use ETB"
				(
					&EtmApp="False"
					do writesettings.cmm
					do etb_settings
				)
				menuitem "ETM auto set-up" "a.af"
			)
			popup "STM Trace"
			(
				menuitem "Config"		"do trace_stm.cmm"
				menuitem "Start sampling"	"do stm_sampling_start.cmm"
				menuitem "Stop sampling"	"do stm_sampling_stop.cmm"
			)
			popup "MC-SBAG Trace"
			(
				menuitem "Config TMSAT"		"do mcsbag_tmsat.cmm"
				menuitem "Config WPSAT"		"do mcsbag_wpsat.cmm"
				menuitem "Start sampling"
				(
					; STM trace start
					do stm_sampling_start.cmm
					; Enable MCSBAG to start capturing
					data.set eahb:0xa0390000 %long data.long(eahb:0xa0390000)|0x1
				)
				menuitem "Stop sampling"
				(
					; Disable MCSBAG to stop capturing
					data.set eahb:0xa0390000 %long 0x0
					; STM trace stop
					do stm_sampling_stop.cmm
				)
			)
			separator
			if simulator()
			(
				menuitem "Reload trace and memory dump" "do load_trace_and_dump"
			)
			else
			(
				menuitem "Save trace and memory" "do save_trace_and_dump"
				menuitem "Save CPU State" "do save_state"
				separator
				menuitem "Analyse DB9540 & AB9540 registers" "do dump_regs_dialog ALL"
				popup "Dump DB9540 registers to file"
				(
					menuitem "CR" "do dump_regs_dialog DB CR"
					menuitem "DMA" "do dump_regs_dialog DB DMA"
					menuitem "GPIO0" "do dump_regs_dialog DB GPIO0"
					menuitem "GPIO1" "do dump_regs_dialog DB GPIO1"
					menuitem "GPIO2" "do dump_regs_dialog DB GPIO2"
					menuitem "GPIO3" "do dump_regs_dialog DB GPIO3"
					menuitem "GPIO4" "do dump_regs_dialog DB GPIO4"
					menuitem "GPIO5" "do dump_regs_dialog DB GPIO5"
					menuitem "GPIO6" "do dump_regs_dialog DB GPIO6"
					menuitem "GPIO7" "do dump_regs_dialog DB GPIO7"
					menuitem "GPIO8" "do dump_regs_dialog DB GPIO8"
					menuitem "GPIO9" "do dump_regs_dialog DB GPIO9"
					menuitem "PRCMU" "do dump_regs_dialog DB PRCMU"
				)
				menuitem "Dump AB9540 registers to file" "do dump_regs_dialog AB"
			)
			if !simulator()
			(
				separator
				menuitem "Check PC on a running target (file saved as read_reg_pc.txt)"
				(
					DIALOG
					(
						POS 1. 1. 15.
						TEXT "Number of iterations:"
						POS 1. 2. 15.
						num: EDIT "5000" ""
						POS 6. 4. 5.
						DEFBUTTON "OK" "CONTinue"
					)
					STOP
					&num=dialog.string(num)
					DIALOG.END
					do read_reg_pc &(num).
				)
			)
		)
	)

	add
	toolbar
	(
			separator
			toolitem "Synch Setup" "do synch_setup.cmm"
[
MMMMMMMMMMMMMMMM
MMMMMMMMMMMMMMMM
MMMMMMMMMMMMMMMM
MMMMMMMMMMMMMMMM
XXXMXMMMXMXMMMXM
XMMMXMMMXMXXMMXM
XMMMMXMXMMXXMMXM
XXXMMXMXMMXMXMXM
MMXMMMXMMMXMXMXM
MMXMMMXMMMXMMXXM
XXXMMMXMMMXMMXXM
MMMMMMMMMMMMMMMM
MMMMMMMMMMMMMMMM
MMMMMMMMMMMMMMMM
MMMMMMMMMMMMMMMM
MMMMMMMMMMMMMMMM
]
		        toolitem "Etm Selection" "do etm_select.cmm"
[
CCCCCCCCCCCCCCCC
CCCCCCCCCCCCCCCC
CCCCCCCCCCCCCCCC
CCCCCCCCCCCCCCCC
XXXCXXXXXCXCCCXC
XCCCCCXCCCXXCXXC
XCCCCCXCCCXCXCXC
XCCCCCXCCCXCCCXC
XXXCCCXCCCXCCCXC
XCCCCCXCCCXCCCXC
XCCCCCXCCCXCCCXC
XXXCCCXCCCXCCCXC
CCCCCCCCCCCCCCCC
CCCCCCCCCCCCCCCC
CCCCCCCCCCCCCCCC
CCCCCCCCCCCCCCCC
	]
		toolitem "STM trace" "do trace_stm"
		[
YYYYYYYYYYYYYYYY
YYYYYYYYYYYYYYYY
YYYYYYYYYYYYYYYY
YYYYYYYYYYYYYYYY
YYYYYYYYYYYYYYYY
XXXYXXXXXYXYYYXY
XYYYYYXYYYXXYXXY
XYYYYYXYYYXYXYXY
XXXYYYXYYYXYYYXY
YYXYYYXYYYXYYYXY
YYXYYYXYYYXYYYXY
XXXYYYXYYYXYYYXY
YYYYYYYYYYYYYYYY
YYYYYYYYYYYYYYYY
YYYYYYYYYYYYYYYY
YYYYYYYYYYYYYYYY
		]
	)
)
