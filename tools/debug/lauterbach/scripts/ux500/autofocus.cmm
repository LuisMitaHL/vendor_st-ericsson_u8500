

if "&LinuxDebug"=="TRUE"
(
	&i=0
	a.af
	while &i<5
	( 
	  a.tf /accumulate
	  &i=&i+1
	)
)
else
(
	&i=0
	a.af 0++1000
	while &i<5
	( 
	  a.tf 0++1000 /accumulate
	  &i=&i+1
	)
)

enddo 
 
