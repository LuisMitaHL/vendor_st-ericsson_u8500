;------------------------------------------------------------
; synch_update_variables.cmm
;------------------------------------------------------------
; Used by synch_setup to synchronize &SynchAcc on bot Acc and App
;
; 090527 - NJ Initial version
;-----------------------------------------------------------

ENTRY &entry1

&SynchAcc="&entry1"