;------------------------------------------------------------
; menu.cmm
;------------------------------------------------------------
; Create target specific menu
;
; 101208 - KM Initial version
;-----------------------------------------------------------


menu.rp
(
	add
	menu
	(
		POPUP "U5500_ACC"
		(
			separator
			popup "Trace"
			(
				menuitem "Use ETM" "do etm_settings"
				menuitem "Use ETB" "Trace.Method ONCHIP"
		        	menuitem "ETM auto set-up" "a.af"
			)
			separator
		)
	)
)