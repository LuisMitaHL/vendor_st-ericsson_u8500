;------------------------------------------------------------
; etm_update_variables.cmm
;------------------------------------------------------------
; Used by etm_Select to synchronize &EtmAcc on bot Acc and App
;
; 090508 - KM Initial version
;-----------------------------------------------------------

ENTRY &entry1 &entry2 &entry3

&EtmAcc="&entry1"
&AccDataTrace="&entry2"
&EtmPortSize="&entry3"

enddo