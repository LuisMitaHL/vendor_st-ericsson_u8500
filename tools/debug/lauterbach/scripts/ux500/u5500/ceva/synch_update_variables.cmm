;------------------------------------------------------------
; synch_update_variables.cmm
;------------------------------------------------------------
; Used by synch_setup to synchronize &SynchCeva on bot Ceva and App
;
; 090527 - NJ Initial version
;-----------------------------------------------------------

ENTRY &entry1

&SynchCeva="&entry1"