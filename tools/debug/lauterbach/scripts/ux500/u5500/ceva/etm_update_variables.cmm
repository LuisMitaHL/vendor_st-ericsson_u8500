;------------------------------------------------------------
; etm_update_variables.cmm
;------------------------------------------------------------
; Used by etm_Select to synchronize &EtmCeva on both Ceva and App
;
; 090508 - KM Initial version
;-----------------------------------------------------------

ENTRY &entry1 &entry2 &entry3

&EtmCeva="&entry1"
&CevaDataTrace="&entry2"
&EtmPortSize="&entry3"

enddo