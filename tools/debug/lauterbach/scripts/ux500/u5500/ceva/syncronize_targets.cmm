;------------------------------------------------------------
; syncronize_targets.cmm
;------------------------------------------------------------
;
; 090508 - KM Initial version
;-----------------------------------------------------------

// Prepare for syncronize debuggers

;What cores are we debugging?
if INTERCOM.PING(&icAcc)
	&AccStarted="True"
if INTERCOM.PING(&icApp)
	&AppStarted="True"
if INTERCOM.PING(&icCeva)
	&CevaStarted="True"

 SYNCH.MASTERGO ON
 SYNCH.MASTERBREAK ON
 SYNCH.MASTERSTEP OFF
 SYNCH.SLAVEGO ON
 SYNCH.SLAVEBREAK ON
 SYNCH.SLAVESTEP OFF
 if ("&AppStarted"=="True")&&("&AccStarted"=="True")
 	SYNCH.CONNECT &icApp &icAcc
 else if ("&AppStarted"=="True")
	SYNCH.CONNECT &icApp
 else if ("&AccStarted"=="True")
	SYNCH.CONNECT &icAcc

  sys.memaccess DAP
  SYNCH.OFF
  SYNCH.ON	  ;bugfix
 if "&SynchCeva"=="False"
	SYNCH.OFF
 else
	SYNCH.ON

  sys.memaccess denied
 ENDDO
