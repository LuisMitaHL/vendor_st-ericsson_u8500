;------------------------------------------------------------
; general_path_settings.cmm
;------------------------------------------------------------
; Override of cpt path settings
;
; 110526 - KM Initial version
;-----------------------------------------------------------


enddo