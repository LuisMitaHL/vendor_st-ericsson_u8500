&pc_entry
&pc_entry=r(pc)
core.select 1
r.s pc &pc_entry
core.select 0
