;*****************************************************************************
;*  ST-Ericsson                                                              *
;*  Reproduction and Communication of this document is strictly prohibited   *
;*  unless specifically authorized in writing by ST-Ericsson.                *
;*---------------------------------------------------------------------------*/

;****************************************************************************
;* Author        : Emmanuel EDDI
;* Description   : This Code/Script is for Folllowing Board Configuration:
;*
;*                 Board            :   Maja Validation Board.
;*                 Nomadik          :   DB5500V1 (Maja)
;*                 Flash Memory     :   .
;*                 MuxOneNAND       :   .
;*                 Ethernet         :   .
;*                 SRAM             :   .
;*                 NOR              :   .
;*                 Code/Script for  :   Lauterbach / Trace32
;*                 Version          :   V1.3
;*
;*
;* File Name     : DB5500_SoC_settings_noDDR.cmm
;*----------------------------------------------------------------------------*/
LOCAL &FW_version &API_version

;#######################################
;#    Check PRCMU FW and API version
;#######################################
&FW_version="(d.l(d:&pfw_prcmu_fw_version))"
&API_version="(d.b(d:&pfw_prcmu_api_version))"
print "PRCMU FW version 0x" &FW_version " loading for DB5500V1..."
print "PRCMU API version: 0x" &API_version

if &FW_version<0x8
(
	print "PRCMU API version is not the proper one (for SWDOG Work-Around)"
	print "ERROR you NEED to download a PRCMU Fw with PRCMU API greater than or equal to version 0x8 !!!"	
)
else if &API_version!=&CMM_API_VERSION
(
	print "PRCMU API version is not in line with the one specified in prcmu_mailbox_setup.cmm"
)
else
(
	;#######################################
	;#         Release some resets/GPIOs
	;#######################################
	;# Release reset for all GPIOs
	data.set 0x80157208 %long 0xFFFF
	
	
	;#######################################
	;#         Re-program ICN registers
	;#######################################
	data.set 0x8015BE10 %long 0x7F		;TO grant access to all ICN Masters
	
	
	;#######################################
	;#         Switch xP70 Fw in ApExecute
	;#######################################
	print "Switch xP70 Fw in ApExecute..."
	
	data.set &pfw_reqMb0_H %byte 0x01			; header->Req
	data.set &pfw_req_mb_0_ap_pwr_st_tr %byte 0x01		; ApExecute mode requested (Boot to Execute mode transition)
	data.set 0x80157100 %long 0x00000001			; Sent IT to xP70
	
	&loop=1
	while ((((d.b(d:&pfw_pwr_current_state_var))!=0x02)||((d.b(d:&pfw_ap_pwr_st_tr_status))!=0xFF))&&&loop<200.)		;APS_EXECUTE in ShVar1 or BootToExecuteOk in AckMB0
	(
		&loop=&loop+1
	)
	if &loop>=200.
	(
		print "ERROR: XP70 didn't send any IT to CA9 !"
	)
	else
	(
	  	print " ApsExecute state reached..."
		; No IT sent from XP70 to CA9
	)
	
	
	;##############################################
	;#         Program LpDDR2 
	;##############################################
	print "LpDDR2 NOT CONFIGURED with this script !!"
	
	
	;##############################################
	;#         Re-Program AB5500V1 (Petra) 
	;##############################################
	print "Reprogram AB5500 registers stage is skipped for now !!"
	
	
	;#######################################
	;#         Modem start-up
	;#######################################
	print "Access Sub-System (Modem) start up is not covered by this settings initialization file !!!"
)
