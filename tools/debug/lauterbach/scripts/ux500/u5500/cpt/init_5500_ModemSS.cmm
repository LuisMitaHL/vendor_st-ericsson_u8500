; #####################################################################
; # DB5500 debug & Trace script file: init_5500_ModemSS.cmm           #
; # Copyright (C) 2011, STMicroelectronics. All Rights Reserved       #
; #####################################################################
; This script is used for Trace32 debug configuration on 5500.
; Created by HED/CSP/CPT/ACT on 2010-05-19
; Contact: jingyi-xiaoyan.lu@st.com
; 2010-09-17: New platform names support; 
; 2010-10-21: V2 support.
; 2011-03-15: added "semihost" parameter in dbg_config.
;	      restructure ==> the main body is more readable.

;!!!!!!!!!!!!!!!!!!!!!!!!!!!
; PLEASE CHECK OR UPDATE THE "SECTION_3" of this script before integrate this script into your working environment.
;!!!!!!!!!!!!!!!!!!!!!!!!!!!
;
; This script is used for debug and SoC configuration on DB5500-MODEMSS.
;
; ---- Usage and Parameters
; Usage: do init_5500_ModemSS <5500_ver> <platform> <dbg_config> <core>
; Parameters:
; <5500_ver> indicates the version of DB5500. It can be
;	v1:		means DB5500-V1.
;	v2:		means DB5500-V2.
; <platform> indicates the name of platform on which this script is executed. It can be
;	B5500:		means big board.
;	S5500 :		means small board.
;	EVB:		means Electrical Validation Board.
;	palladium	means Palladium platform
; <dbg_config> indicates the configuration related to the debugging. It can be one of the following values or a combination of them. Use "+" for the combination, like "attach+cjtag2pin"
;	attach:		means the "system.mode.attach" command is used to connect the Trace32 debugger to the CortexR4 core. 
;			The system and core status keep intact in this case. It can not be combined with "up".
;	up:		means the "system.up" Trace32 command is used to connect the Trace32 debugger to the CortexR4 core, and a SYSTEM RESET is issued by the script. It can not be combined with "attach".
;	cjtag2pin:	means configure the debugger to the cJTAG 2-Pin (star-2) mode.
;			NOTE THAT the cJTAG is in 4-Pin (wide) mode after the DB5500 boot. Without this value, the debugging is run in cJTAG 4-pin mode.
;	semihost	means configuration script for the semihosting settings. This option opens and configures the terminal window.
; <core> can be
;	arm9:		means the Trace32 debugger is connected to the ARM926.
;	ceva:		means the Trace32 debugger is connected to the CEVA-DSP.
;
; All parameters are mandatory. Any error in the parameter syntax will cause the execution of the script to quit.

local &cur_dir
entry &5500_ver &platform &dbg_config &core
area

////////////////////////////////////////////////////////////////////
//
// SECTION_1: 
// Parameters stuff
//
////////////////////////////////////////////////////////////////////
gosub HandleParameters

////////////////////////////////////////////////////////////////////
//
// SECTION_2: 
// Debugger configuration (Do not modify)
//
////////////////////////////////////////////////////////////////////
gosub ConfigDebug

////////////////////////////////////////////////////////////////////
//
// SECTION_3:
// Please give your approriate configuration scripts here below if needed
//
////////////////////////////////////////////////////////////////////
;--- call other configuration script here


enddo (0==0)

















; =================== Sub Functions ===================


HandleParameters:
	; ---- Parameter Check
	if string.upr("&5500_ver")!="V1"&&string.upr("&5500_ver")!="V2"
	(
		print "Unknow DB5500 version: &5500_ver !"
		enddo
	)
	&5500_ver=string.upr("&5500_ver")
	if string.upr("&platform")!="B5500"&&string.upr("&platform")!="S5500"&&string.upr("&platform")!="PALLADIUM"&&string.upr("&platform")!="EVB"
	(
		print "Unknown platform: &platform !"
		enddo
	)
	&platform=string.upr("&platform")
	if string.upr("&core")!="ARM9"&&string.upr("&core")!="CEVA"
	(
		print "Unknown CPU! Expected parameter: ARM9 or CEVA"
		enddo
	)
	&core=string.upr("&core")
	// &dbg_config parameter is checked by the debug config scrips called by this script.
	return

ConfigDebug:
	; ---- general GUI settings
	&cur_dir=os.ppd()
	do "&cur_dir/general_gui_setting.cmm"
	
	; ---- path setting
	do "&cur_dir/general_path_setting.cmm"
	 
	;--- call debug configuration script
	if "&core"=="ARM9"
		do "&cur_dir/5500_debug_config_ARM9.cmm" &5500_ver &platform &dbg_config DB5500MOD
	else
		do "&cur_dir/5500_debug_config_CEVA.cmm" &5500_ver &platform &dbg_config DB5500MOD
	return
