; #####################################################################
; # DB5500 debug & Trace script file: trace_config.cmm                #
; # Copyright (C) 2011, STMicroelectronics. All Rights Reserved       #
; #####################################################################
; This script is used to configure the PTM/ETM trace capture via TPIU and ETM preprocessor 
; Crated by HED/CSP/CPT/ACT on 2010-10-28
; Contact jingyi-xiaoyan.lu@st.com

if analyzer()
(
	trace.method.analyzer
	etm.portmode continuous
	etm.portsize 16.
	analyzer.autofocus
)
else
(
	print "The ETM preprocessor is not present, use ETB (onchip) for trace capture."
	trace.method.onchip
)	
trace
enddo
