; #####################################################################
; # DB5500 debug & Trace script file: Mod_NoPwrDwn.cmm                #
; # Copyright (C) 2011, STMicroelectronics. All Rights Reserved       #
; #####################################################################
; set/reset the MOD_DBGNOPWRDWN. Registered by the PRCMU within the CSYSPWRUPREQ/ACK sequence.
; Created by HED/CSP/CPT/ACT on 2010-06-10
; contact: jingyi-xiaoyan.lu@st.com

entry &requested_val

if "&requested_val"==""||("&requested_val"!="0"&&"&requested_val"!="1")
(
	print "Need parameter 0 or 1."
	enddo
)

&PRCM_DBG_PWRCTL_addr=0x801574AC
&MODNOPWRDN_bitpos=2
if &requested_val==1
	data.set eahb:&PRCM_DBG_PWRCTL_addr %long d.l(eahb:&PRCM_DBG_PWRCTL_addr)|1<<&MODNOPWRDN_bitpos
else
	data.set eahb:&PRCM_DBG_PWRCTL_addr %long d.l(eahb:&PRCM_DBG_PWRCTL_addr)&~(1<<&MODNOPWRDN_bitpos)
sys.down
sys.m.attach
enddo
