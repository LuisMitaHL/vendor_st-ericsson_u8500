;------------------------------------------------------------
; onchip_break_setup.cmm
;------------------------------------------------------------
;
; 091210 - KM Initial version
;-----------------------------------------------------------

map.bonchip 0x0--0xffffffff

ENDDO
