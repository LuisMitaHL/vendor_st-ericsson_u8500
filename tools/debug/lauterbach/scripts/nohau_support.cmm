;------------------------------------------------------------
; nohau_support.cmm
;------------------------------------------------------------
; Sets up the Nohau supportpage
;
; 060615 - PH, Initial version
; 060619 - PH, Done
; 061122 - KM, Added CMM-build number
; 070405 - PH, Added CMM-build number
; 090403 - NJ, support email address changed
;-----------------------------------------------------------

dialog
(
	icon "[,    BBBBBBBS,   BBBBBBBBBS,  BBBBBBBBBBBS,  BBBBS  BBBBS,  BBBS    BBBS,  BBBS    BBBS,  BBBS    BBBS,  BBBS    BBBS,  BBBS    BBBS,  BBBS    BBBS,  BBBS    BBBS,  BBBS    BBBS,  BBBS    BBBS,  BBBS    BBBS,  SSSS    SSSS]"
	header "Support"
	pos 1. 0. 17. 2.
  	text "Nohau Support"
	pos 0. 2. 18. 3.
	box "E-Mail"
	pos 1. 3. 15. 1.
	text "emp_support@nohau.se"
	pos 0. 5. 18. 3.
	box "Phone"
	pos 1. 6. 15. 1.
	text "040 - 625 35 25"
  	pos 0. 8. 18. 5.
	box "Address"
	pos 1. 9. 15. 1.
 	text "Nohau Solutions AB"
	pos 1. 10. 15. 1.
 	text "Derbyvägen 4"
	pos 1. 11. 15. 1.
 	text "SE-212 35  MALMÖ"
	pos 0. 13. 18. 3.
	box "CMM-build:"
	pos 1. 14. 10. 1.
	text "3.19.0"
	pos 5. 16. 8. 1.
	defbutton "Close" "dialog.end"
)

ENDDO





