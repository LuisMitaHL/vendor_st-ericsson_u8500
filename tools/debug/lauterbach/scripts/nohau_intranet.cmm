;------------------------------------------------------------
; nohau_intranet.cmm
;------------------------------------------------------------
; Opens the Nohau support page on ST-Ericsson intranet from TRACE32
;
; 090911 - NJ, created
;-----------------------------------------------------------


os cmd /C start "" "\\eseldna003\bmtpapps\bmtptools\UTIL\Debuggers\Lauterbach\nohau_service_agreement_homepage\Nohau--Ink---EMP-homepage.htm"


ENDDO





