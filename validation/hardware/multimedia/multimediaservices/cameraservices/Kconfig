## validation/hardware/multimedia/multimediaservices/cameraservices/Kconfig
```kconfig
#
# Cameraservices configuration
#

menuconfig CAMERASERVICES
	bool "Cameraservices Configuration"
	help
	  This module provides camera services to control and test Ux500 board

if CAMERASERVICES

config CAMERASERVICES_DIR
	string
	default ./multimediaservices/cameraservices

config CAMERASERVICES_DEPS
	string
	default ""

config CAMERASERVICES_STRIP_DISABLED
	bool "Disable strip"
	depends on CAMERASERVICES
	default n
	help
	  This will disable strip for this module

config CAMERASERVICES_DEBUG_ENABLED
	bool "Enable debug"
	depends on CAMERASERVICES
	default n
	help
	  This will enable debug configuration for this module

endif # CAMERASERVICES
```

## validation/hardware/multimedia/multimediaservices/iqtservices/Kconfig
```kconfig
#
# Iqtservices configuration
#

menuconfig IQTSERVICES
	bool "Iqtservices Configuration"
	help
	  This module provides IQ tuning tools to control and test Ux500 board

if IQTSERVICES

config IQTSERVICES_DIR
	string
	default ./multimediaservices/iqtservices

config IQTSERVICES_DEPS
	string
	default ""

config IQTSERVICES_STRIP_DISABLED
	bool "Disable strip"
	depends on IQTSERVICES
	default n
	help
	  This will disable strip for this module

config IQTSERVICES_DEBUG_ENABLED
	bool "Enable debug"
	depends on IQTSERVICES
	default n
	help
	  This will enable debug configuration for this module

endif # IQTSERVICES
```

## validation/hardware/multimedia/multimediaservices/videoservices/Kconfig
```kconfig
#
# Videoservices configuration
#

menuconfig VIDEOSERVICES
	bool "Videoservices Configuration"
	depends on LIBPNG && LIBAB
	help
	  This module provides video tools to control and test Ux500 board

if VIDEOSERVICES

config VIDEOSERVICES_DIR
	string
	default ./multimediaservices/videoservices

config VIDEOSERVICES_DEPS
	string
	default "LIBPNG LIBAB"

config VIDEOSERVICES_STRIP_DISABLED
	bool "Disable strip"
	depends on VIDEOSERVICES
	default n
	help
	  This will disable strip for this module

config VIDEOSERVICES_DEBUG_ENABLED
	bool "Enable debug"
	depends on VIDEOSERVICES
	default n
	help
	  This will enable debug configuration for this module

endif # VIDEOSERVICES
```

## validation/hardware/power/powerservices/Kconfig
```kconfig
#
# Powerservices configuration
#

menu "Powerservices Configuration"

menuconfig POWERSERVICES
		bool "Powerservices Configuration"
		depends on ((AB_LIB_8500 || AB_LIB_8505)&& ISI_DRIVER_LIB && MODEM_LIB && LIBAB && LIBDB)||((AB_LIB_9540 || AB_LIB_8540 || AB_LIB_X600) && LIBAB && LIBDB && DTHLMODEMMNGT)
		help
	  	This module provides routines to manage power
 

if POWERSERVICES

config PWS_9540
	bool "Enable PWS 9540"
	default n
	help
	Specific use power 9540

config PWS_8540
	bool "Enable PWS 8540"
	default n
	help
	Specific use power 8540

config POWERSERVICES_DIR
	string
	default ./powerservices

config POWERSERVICES_DEPS
	string
	default "ISI_DRIVER_LIB MODEM_LIB LIBAB LIBDB" if (AB_LIB_8500 || AB_LIB_8505)
	default "LIBAB LIBDB DTHLMODEMMNGT" if AB_LIB_9540 || AB_LIB_8540 || AB_LIB_X600

config POWERSERVICES_STRIP_DISABLED
	bool "Disable strip"
	depends on POWERSERVICES
	default n
	help
	  This will disable strip for this module

config POWERSERVICES_DEBUG_ENABLED
	bool "Enable debug"
	depends on POWERSERVICES
	default n
	help
	  This will enable debug configuration for this module

endif # POWERSERVICES

endmenu
```

## validation/hardware/tat/DthFramework/Kconfig
```kconfig
menu "DthFramework Packages Configuration"
source "../tat/DthFramework/spfs/Kconfig"
source "../tat/DthFramework/genAPIdoc/Kconfig"
source "../tat/DthFramework/dthhelper/dthsrvhelper/Kconfig"
source "../tat/DthFramework/dthhelper/dthfs/Kconfig"
source "../tat/DthFramework/libtatasync/Kconfig"
source "../tat/DthFramework/dthfilter/Kconfig"
source "../tat/DthFramework/include/Kconfig"
endmenu
```

## validation/hardware/tat/DthFramework/dthfilter/Kconfig
```kconfig
#
# DthFilter configuration
#

menuconfig DTHFILTER
	bool "DthFilter"
	help


if DTHFILTER

config DTHFILTER_DIR
	string
	default ../tat/DthFramework/dthfilter

config DTHFILTER_DEPS
	string
	default ""

config DTHFILTER_STRIP_DISABLED
	bool "Disable strip"
	depends on DTHFILTER
	default n
	help
	  This will disable strip for this module

config DTHFILTER_DEBUG_ENABLED
	bool "Enable debug"
	depends on DTHFILTER
	default n
	help
	  This will enable debug configuration for this module

endif # DTHFILTER
```

## validation/hardware/tat/DthFramework/dthhelper/dthfs/Kconfig
```kconfig
#
# Dthfs configuration
#

menuconfig DTHFS
	bool "Dthfs"
	depends on DTHFRAMEWORK-INCLUDE
	help
	  depends on DTHFRAMEWORK-INCLUDE


if DTHFS

config DTHFS_DIR
	string
	default ../tat/DthFramework/dthhelper/dthfs

config DTHFS_DEPS
	string
	default "DTHFRAMEWORK-INCLUDE"

config DTHFS_STRIP_DISABLED
	bool "Disable strip"
	depends on DTHFS
	default n
	help
	  This will disable strip for this module

config DTHFS_DEBUG_ENABLED
	bool "Enable debug"
	depends on DTHFS
	default n
	help
	  This will enable debug configuration for this module

endif # DTHFS
```

## validation/hardware/tat/DthFramework/dthhelper/dthsrvhelper/Kconfig
```kconfig
#
# DthSrvHelper configuration
#

menuconfig DTHSRVHELPER
	bool "DthSrvHelper"
	depends on DTHFRAMEWORK-INCLUDE && DTHFS && LIBXML2
	help
	  depends on DTHFRAMEWORK-INCLUDE, DTHFS and LIBXML2


if DTHSRVHELPER

config DTHSRVHELPER_DIR
	string
	default ../tat/DthFramework/dthhelper/dthsrvhelper

config DTHSRVHELPER_DEPS
	string
	default "DTHFRAMEWORK-INCLUDE DTHFS LIBXML2 "

config DTHSRVHELPER_STRIP_DISABLED
	bool "Disable strip"
	depends on DTHSRVHELPER
	default n
	help
	  This will disable strip for this module

config DTHSRVHELPER_DEBUG_ENABLED
	bool "Enable debug"
	depends on DTHSRVHELPER
	default n
	help
	  This will enable debug configuration for this module

endif # DTHSRVHELPER
```

## validation/hardware/tat/DthFramework/genAPIdoc/Kconfig
```kconfig
#
# GenAPIdoc configuration
#

menuconfig GENAPIDOC
	bool "GenAPIdoc"
	depends on DTHSRVHELPER && DTHFRAMEWORK-INCLUDE && DTHFS && LIBXML2
	help
	  depends on DTHSRVHELPER, DTHFRAMEWORK-INCLUDE, DTHFS && LIBXML2

if GENAPIDOC

config GENAPIDOC_DIR
	string
	default ../tat/DthFramework/genAPIdoc

config GENAPIDOC_DEPS
	string
	default "DTHSRVHELPER DTHFRAMEWORK-INCLUDE DTHFS LIBXML2"

config GENAPIDOC_STRIP_DISABLED
	bool "Disable strip"
	depends on GENAPIDOC
	default n
	help
	  This will disable strip for this module

config GENAPIDOC_DEBUG_ENABLED
	bool "Enable debug"
	depends on GENAPIDOC
	default n
	help
	  This will enable debug configuration for this module

endif # GENAPIDOC
```

## validation/hardware/tat/DthFramework/include/Kconfig
```kconfig
#
# Dthframework-include configuration
#

menuconfig DTHFRAMEWORK-INCLUDE
	bool "Dthframework-include"
	help
	  
if DTHFRAMEWORK-INCLUDE

config DTHFRAMEWORK-INCLUDE_DIR
	string
	default ../tat/DthFramework/include

config DTHFRAMEWORK-INCLUDE_DEPS
	string
	default ""

config DTHFRAMEWORK-INCLUDE_STRIP_DISABLED
	bool "Disable strip"
	depends on DTHFRAMEWORK-INCLUDE
	default n
	help
	  This will disable strip for this module

config DTHFRAMEWORK-INCLUDE_DEBUG_ENABLED
	bool "Enable debug"
	depends on DTHFRAMEWORK-INCLUDE
	default n
	help
	  This will enable debug configuration for this module

endif # DTHFRAMEWORK-INCLUDE
```

## validation/hardware/tat/DthFramework/libtatasync/Kconfig
```kconfig
#
# LibTatasync configuration
#

menuconfig LIBTATASYNC
	bool "LibTatasync"
	depends on OPENSSL && DTHFRAMEWORK-INCLUDE
	help
	  depends on OPENSSL, DTHFRAMEWORK-INCLUDE

if LIBTATASYNC

config LIBTATASYNC_DIR
	string
	default ../tat/DthFramework/libtatasync

config LIBTATASYNC_DEPS
	string
	default "OPENSSL DTHFRAMEWORK-INCLUDE"

config LIBTATASYNC_STRIP_DISABLED
	bool "Disable strip"
	depends on LIBTATASYNC
	default n
	help
	  This will disable strip for this module

config LIBTATASYNC_DEBUG_ENABLED
	bool "Enable debug"
	depends on LIBTATASYNC
	default n
	help
	  This will enable debug configuration for this module

endif # LIBTATASYNC
```

## validation/hardware/tat/DthFramework/spfs/Kconfig
```kconfig
#
# spfs configuration
#

menuconfig SPFS
	bool "spfs"
	depends on DTHSRVHELPER
	help

if SPFS

config SPFS_DIR
	string
	default ../tat/DthFramework/spfs

config SPFS_DEPS
	string
	default "DTHSRVHELPER"

config SPFS_STRIP_DISABLED
	bool "Disable strip"
	depends on SPFS
	default n
	help
	  This will disable strip for this module

config SPFS_DEBUG_ENABLED
	bool "Enable debug"
	depends on SPFS
	default n
	help
	  This will enable debug configuration for this module

endif # SPFS
```

## validation/hardware/tat/application/Kconfig
```kconfig
#
# Tatapplication configuration
#

menu "Tatapplication"

menuconfig TATAPPLICATION
	bool "Tatapplication"
	depends on LIBAB && LIBDB && LIBI2C
	help
	  depends on LIBAB, LIBDB and LIBI2C

if TATAPPLICATION

config TATAPPLICATION_DIR
	string
	default ../tat/application

config TATAPPLICATION_DEPS
	string
	default "LIBAB LIBDB LIBI2C"

config TATAPPLICATION_STRIP_DISABLED
	bool "Disable strip"
	depends on TATAPPLICATION
	default n
	help
	  This will disable strip for this module

config TATAPPLICATION_DEBUG_ENABLED
	bool "Enable debug"
	depends on TATAPPLICATION
	default n
	help
	  This will enable debug configuration for this module

endif # TATAPPLICATION

endmenu
```

## validation/hardware/tat/generalservices/Kconfig
```kconfig
menu "GeneralServices Packages Configuration"
source "../tat/generalservices/ab_ape/Kconfig"
source "../tat/generalservices/libab/Kconfig"
source "../tat/generalservices/libdb/Kconfig"
source "../tat/generalservices/libi2c/Kconfig"
source "../tat/generalservices/libtreedyn/Kconfig"
source "../tat/generalservices/dthtreedyn/Kconfig"
endmenu
```

## validation/hardware/tat/generalservices/ab_ape/Kconfig
```kconfig
#
# Ab_APE configuration
#

menuconfig AB_APE
	bool "Ab_ape"
	depends on LIBAB && DTHSRVHELPER
	help
	  depends on LIBAB

if AB_APE

config AB_APE_DIR
	string
	default ../tat/generalservices/ab_ape

config AB_APE_DEPS
	string
	default "LIBAB DTHSRVHELPER"

config AB_APE_STRIP_DISABLED
	bool "Disable strip"
	depends on AB_APE
	default n
	help
	  This will disable strip for this module

config AB_APE_DEBUG_ENABLED
	bool "Enable debug"
	depends on AB_APE
	default n
	help
	  This will enable debug configuration for this module

endif # AB_APE
```

## validation/hardware/tat/generalservices/dthtreedyn/Kconfig
```kconfig
#
# DthTreeDyn configuration
#

menuconfig DTHTREEDYN
	bool "DthTreeDyn"
	depends on DTHSRVHELPER
	help
	  depends on DTHSRVHELPER	  

if DTHTREEDYN

config DTHTREEDYN_DIR
	string
	default ../tat/generalservices/dthtreedyn

config DTHTREEDYN_DEPS
	string
	default "DTHSRVHELPER"

config DTHTREEDYN_STRIP_DISABLED
	bool "Disable strip"
	depends on DTHTREEDYN
	default n
	help
	  This will disable strip for this module

config DTHTREEDYN_DEBUG_ENABLED
	bool "Enable debug"
	depends on DTHTREEDYN
	default n
	help
	  This will enable debug configuration for this module

endif # DTHTREEDYN
```

## validation/hardware/tat/generalservices/libab/Kconfig
```kconfig
#
# LibAB configuration
#

menuconfig LIBAB
	bool "LibAB"
	help

if LIBAB

config LIBAB_DIR
	string
	default ../tat/generalservices/libab

config LIBAB_DEPS
	string
	default ""

config LIBAB_STRIP_DISABLED
	bool "Disable strip"
	depends on LIBAB
	default n
	help
	  This will disable strip for this module

config LIBAB_DEBUG_ENABLED
	bool "Enable debug"
	depends on LIBAB
	default n
	help
	  This will enable debug configuration for this module

endif # LIBAB
```

## validation/hardware/tat/generalservices/libdb/Kconfig
```kconfig
#
# LibDB configuration
#

menuconfig LIBDB
	bool "LibDB"
	help

if LIBDB

config LIBDB_DIR
	string
	default ../tat/generalservices/libdb

config LIBDB_DEPS
	string
	default ""

config LIBDB_STRIP_DISABLED
	bool "Disable strip"
	depends on LIBDB
	default n
	help
	  This will disable strip for this module

config LIBDB_DEBUG_ENABLED
	bool "Enable debug"
	depends on LIBDB
	default n
	help
	  This will enable debug configuration for this module

endif # LIBDB
```

## validation/hardware/tat/generalservices/libi2c/Kconfig
```kconfig
#
# LibI2C configuration
#

menuconfig LIBI2C
	bool "LibI2C"
	help

if LIBI2C

config LIBI2C_DIR
	string
	default ../tat/generalservices/libi2c

config LIBI2C_DEPS
	string
	default ""

config LIBI2C_STRIP_DISABLED
	bool "Disable strip"
	depends on LIBI2C
	default n
	help
	  This will disable strip for this module

config LIBI2C_DEBUG_ENABLED
	bool "Enable debug"
	depends on LIBI2C
	default n
	help
	  This will enable debug configuration for this module

endif # LIBI2C
```

## validation/hardware/tat/generalservices/libtreedyn/Kconfig
```kconfig
#
# LibTreeDyn configuration
#

menuconfig LIBTREEDYN
	bool "LibTreeDyn"
	help

if LIBTREEDYN

config LIBTREEDYN_DIR
	string
	default ../tat/generalservices/libtreedyn

config LIBTREEDYN_DEPS
	string
	default ""

config LIBTREEDYN_STRIP_DISABLED
	bool "Disable strip"
	depends on LIBTREEDYN
	default n
	help
	  This will disable strip for this module

config LIBTREEDYN_DEBUG_ENABLED
	bool "Enable debug"
	depends on LIBTREEDYN
	default n
	help
	  This will enable debug configuration for this module

endif # LIBTREEDYN
```

## validation/hardware/tat/tat/Kconfig
```kconfig
menu "Tat Packages Configuration"
source "../tat/tat/tatlcoex/Kconfig"
source "../tat/tat/tatlsim/Kconfig"
source "../tat/tat/tatlrf/Kconfig"
source "../tat/tat/tatlmodem/Kconfig"
source "../tat/tat/tatlcharge/Kconfig"
source "../tat/tat/tatltest/Kconfig"
source "../tat/tat/tatlsd/Kconfig"
source "../tat/tat/tatldb/Kconfig"
source "../tat/tat/tatlpws/Kconfig"
source "../tat/tat/tatlhdmi/Kconfig"
source "../tat/tat/tatladc/Kconfig"
source "../tat/tat/tatlgps/Kconfig"
source "../tat/tat/tatlab/Kconfig"
source "../tat/tat/tatlvideo/Kconfig"
source "../tat/tat/tatliqtuning/Kconfig"
source "../tat/tat/tatlaudio/Kconfig"
source "../tat/tat/tattools/Kconfig"
source "../tat/tat/tatlmodemsrv/Kconfig"
source "../tat/tat/tatlsys/Kconfig"
endmenu
```

## validation/hardware/tat/tat/tatlab/Kconfig
```kconfig
#
# Tatlab configuration
#

menuconfig TATLAB
	bool "Tatlab"
	depends on DTHSRVHELPER && TATTOOLS && LIBTREEDYN && AB_APE && DTHTREEDYN
	help
	  depends on DTHSRVHELPER, TATTOOLS, LIBTREEDYN, DTHTREEDYN and AB_APE

if TATLAB

config TATLAB_DIR
	string
	default ../tat/tat/tatlab

config TATLAB_DEPS
	string
	default "DTHSRVHELPER TATTOOLS LIBTREEDYN DTHTREEDYN AB_APE"

config TATLAB_STRIP_DISABLED
	bool "Disable strip"
	depends on TATLAB
	default n
	help
	  This will disable strip for this module

config TATLAB_DEBUG_ENABLED
	bool "Enable debug"
	depends on TATLAB
	default n
	help
	  This will enable debug configuration for this module

endif # TATLAB
```

## validation/hardware/tat/tat/tatladc/Kconfig
```kconfig
#
# Tatladc configuration
#

menuconfig TATLADC
	bool "Tatladc"
	depends on DTHSRVHELPER && TATTOOLS && LIBAB && AB_APE
	help
	  depends on DTHSRVHELPER, TATTOOLS, LIBAB and AB_APE

if TATLADC

config TATLADC_DIR
	string
	default ../tat/tat/tatladc

config TATLADC_DEPS
	string
	default "DTHSRVHELPER TATTOOLS LIBAB AB_APE"

config TATLADC_STRIP_DISABLED
	bool "Disable strip"
	depends on TATLADC
	default n
	help
	  This will disable strip for this module

config TATLADC_DEBUG_ENABLED
	bool "Enable debug"
	depends on TATLADC
	default n
	help
	  This will enable debug configuration for this module

endif # TATLADC
```
