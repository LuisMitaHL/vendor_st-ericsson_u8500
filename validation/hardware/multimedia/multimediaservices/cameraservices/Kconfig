## validation/hardware/tat/tat/tatlaudio/Kconfig
```kconfig
#
# Tatlaudio configuration
#

menuconfig TATLAUDIO
	bool "Tatlaudio"
	depends on DTHSRVHELPER && TATTOOLS && AUDIOSERVICES && VIDEOSERVICES && AB_APE && LIBTATASYNC
	help
	  depends on DTHSRVHELPER, TATTOOLS, AUDIOSERVICES, VIDEOSERVICES, AB_APE && LIBTATASYNC

if TATLAUDIO

config TATLAUDIO_DIR
	string
	default ../tat/tat/tatlaudio

config TATLAUDIO_DEPS
	string
	default "DTHSRVHELPER TATTOOLS AUDIOSERVICES VIDEOSERVICES AB_APE LIBTATASYNC"

config TATLAUDIO_STRIP_DISABLED
	bool "Disable strip"
	depends on TATLAUDIO
	default n
	help
	  This will disable strip for this module

config TATLAUDIO_DEBUG_ENABLED
	bool "Enable debug"
	depends on TATLAUDIO
	default n
	help
	  This will enable debug configuration for this module

endif # TATLAUDIO
```

## validation/hardware/tat/tat/tatlcharge/Kconfig
```kconfig
#
# TatlCharge configuration
#

menuconfig TATLCHARGE
	bool "TatlCharge"
	depends on DTHSRVHELPER && LIBAB && TATTOOLS && TATLTEST && AB_APE
	help
	  depends on DTHSRVHELPER, LIBAB, TATTOOLS, TATLTEST and AB_APE

if TATLCHARGE

config TATLCHARGE_DIR
	string
	default ../tat/tat/tatlcharge

config TATLCHARGE_DEPS
	string
	default "DTHSRVHELPER LIBAB TATTOOLS TATLTEST AB_APE"

config TATLCHARGE_STRIP_DISABLED
	bool "Disable strip"
	depends on TATLCHARGE
	default n
	help
	  This will disable strip for this module

config TATLCHARGE_DEBUG_ENABLED
	bool "Enable debug"
	depends on TATLCHARGE
	default n
	help
	  This will enable debug configuration for this module

endif # TATLCHARGE
```
