## validation/hardware/tat/tat/tatlcoex/Kconfig
```kconfig
#
# TatlCoex configuration
#

menuconfig TATLCOEX
	bool "TatlCoex"
	depends on DTHSRVHELPER && LIBAB && LIBI2C && TATTOOLS && AUDIOSERVICES && TATLVIDEO && TATLSIM && TATLRF && LIBCONNSERVICES
	help
	  depends on DTHSRVHELPER, LIBAB, LIBI2C, TATTOOLS, AUDIOSERVICES, TATLVIDEO, TATLSIM, TATLRF and LIBCONNSERVICES

if TATLCOEX

config TATLCOEX_DIR
	string
	default ../tat/tat/tatlcoex

config TATLCOEX_DEPS
	string
	default "DTHSRVHELPER LIBAB LIBI2C TATTOOLS AUDIOSERVICES TATLVIDEO TATLSIM TATLRF LIBCONNSERVICES"

config TATLCOEX_STRIP_DISABLED
	bool "Disable strip"
	depends on TATLCOEX
	default n
	help
	  This will disable strip for this module

config TATLCOEX_DEBUG_ENABLED
	bool "Enable debug"
	depends on TATLCOEX
	default n
	help
	  This will enable debug configuration for this module

endif # TATLCOEX
```

## validation/hardware/tat/tat/tatldb/Kconfig
```kconfig
#
# Tatldb configuration
#

menuconfig TATLDB
	bool "Tatldb"
	depends on DTHSRVHELPER && LIBDB && TATTOOLS && LIBTREEDYN && DTHTREEDYN
	help
	  depends on DTHSRVHELPER, LIBDB, TATTOOLS and LIBTREEDYN DTHTREEDYN

if TATLDB

config TATLDB_DIR
	string
	default ../tat/tat/tatldb

config TATLDB_DEPS
	string
	default "DTHSRVHELPER LIBDB TATTOOLS LIBTREEDYN DTHTREEDYN"

config TATLDB_STRIP_DISABLED
	bool "Disable strip"
	depends on TATLDB
	default n
	help
	  This will disable strip for this module

config TATLDB_DEBUG_ENABLED
	bool "Enable debug"
	depends on TATLDB
	default n
	help
	  This will enable debug configuration for this module

endif # TATLDB
```

## validation/hardware/tat/tat/tatlgps/Kconfig
```kconfig
#
# Tatlgps configuration
#

menuconfig TATLGPS
	bool "Tatlgps"
	depends on DTHSRVHELPER && TATTOOLS && ISI_COMMON_LIB && TATLMODEMSRV
	help
	  depends on DTHSRVHELPER, TATTOOLS, ISI_COMMON_LIB and TATLMODEMSRV

if TATLGPS

config TATLGPS_DIR
	string
	default ../tat/tat/tatlgps

config TATLGPS_DEPS
	string
	default "DTHSRVHELPER TATTOOLS ISI_COMMON_LIB TATLMODEMSRV"

config TATLGPS_STRIP_DISABLED
	bool "Disable strip"
	depends on TATLGPS
	default n
	help
	  This will disable strip for this module

config TATLGPS_DEBUG_ENABLED
	bool "Enable debug"
	depends on TATLGPS
	default n
	help
	  This will enable debug configuration for this module

endif # TATLGPS
```

## validation/hardware/tat/tat/tatlhdmi/Kconfig
```kconfig
#
# Tatlhdmi configuration
#

menuconfig TATLHDMI
	bool "Tatlhdmi"
	depends on DTHSRVHELPER && TATTOOLS
	help
	  depends on DTHSRVHELPER and TATTOOLS

if TATLHDMI

config TATLHDMI_DIR
	string
	default ../tat/tat/tatlhdmi

config TATLHDMI_DEPS
	string
	default "DTHSRVHELPER TATTOOLS"

config TATLHDMI_STRIP_DISABLED
	bool "Disable strip"
	depends on TATLHDMI
	default n
	help
	  This will disable strip for this module

config TATLHDMI_DEBUG_ENABLED
	bool "Enable debug"
	depends on TATLHDMI
	default n
	help
	  This will enable debug configuration for this module

endif # TATLHDMI
```

## validation/hardware/tat/tat/tatliqtuning/Kconfig
```kconfig
#
# TatlIqtuning configuration
#

menuconfig TATLIQTUNING
	bool "TatlIqtuning"
	depends on DTHSRVHELPER && IQTSERVICES && TATTOOLS && LIBPNG
	help
	  depends on DTHSRVHELPER, IQTSERVICES, TATTOOLS and LIBPNG

if TATLIQTUNING

config TATLIQTUNING_DIR
	string
	default ../tat/tat/tatliqtuning

config TATLIQTUNING_DEPS
	string
	default "DTHSRVHELPER IQTSERVICES TATTOOLS LIBPNG"

config TATLIQTUNING_STRIP_DISABLED
	bool "Disable strip"
	depends on TATLIQTUNING
	default n
	help
	  This will disable strip for this module

config TATLIQTUNING_DEBUG_ENABLED
	bool "Enable debug"
	depends on TATLIQTUNING
	default n
	help
	  This will enable debug configuration for this module

endif # TATLIQTUNING
```

## validation/hardware/tat/tat/tatlmodem/Kconfig
```kconfig
#
# TatlModem configuration
#

menuconfig TATLMODEM
	bool "TatlModem"
	depends on DTHSRVHELPER && TATLMODEMSRV && TATTOOLS && POWERSERVICES
	help
	  depends on DTHSRVHELPER, TATLMODEMSRV, POWERSERVICES and TATTOOLS

if TATLMODEM

config TATLMODEM_DIR
	string
	default ../tat/tat/tatlmodem

config TATLMODEM_DEPS
	string
	default "DTHSRVHELPER TATLMODEMSRV TATTOOLS POWERSERVICES"

config TATLMODEM_STRIP_DISABLED
	bool "Disable strip"
	depends on TATLMODEM
	default n
	help
	  This will disable strip for this module

config TATLMODEM_DEBUG_ENABLED
	bool "Enable debug"
	depends on TATLMODEM
	default n
	help
	  This will enable debug configuration for this module

endif # TATLMODEM
```

## validation/hardware/tat/tat/tatlmodemsrv/Kconfig
```kconfig
#
# TatlModemSrv configuration
#

menuconfig TATLMODEMSRV
	bool "TatlModemSrv"
	depends on ISI_COMMON_LIB && ISI_DRIVER_LIB && MODEM_LIB
	help
	  depends on ISI_COMMON_LIB, ISI_DRIVER_LIB and MODEM_LIB


if TATLMODEMSRV

config TATLMODEMSRV_DIR
	string
	default ../tat/tat/tatlmodemsrv

config TATLMODEMSRV_DEPS
	string
	default "ISI_COMMON_LIB ISI_DRIVER_LIB MODEM_LIB"

config TATLMODEMSRV_STRIP_DISABLED
	bool "Disable strip"
	depends on TATLMODEMSRV
	default n
	help
	  This will disable strip for this module

config TATLMODEMSRV_DEBUG_ENABLED
	bool "Enable debug"
	depends on TATLMODEMSRV
	default n
	help
	  This will enable debug configuration for this module

endif # TATLMODEMSRV
```

## validation/hardware/tat/tat/tatlpws/Kconfig
```kconfig
#
# Tatlpws configuration
#

menuconfig TATLPWS
	bool "Tatlpws"
	depends on DTHSRVHELPER && LIBAB && TATTOOLS && POWERSERVICES && AB_APE
	help
	  depends on DTHSRVHELPER, LIBAB, TATTOOLS, POWERSERVICES and AB_APE

if TATLPWS

config TATLPWS_DIR
	string
	default ../tat/tat/tatlpws

config TATLPWS_DEPS
	string
	default "DTHSRVHELPER LIBAB TATTOOLS POWERSERVICES AB_APE"

config TATLPWS_STRIP_DISABLED
	bool "Disable strip"
	depends on TATLPWS
	default n
	help
	  This will disable strip for this module

config TATLPWS_DEBUG_ENABLED
	bool "Enable debug"
	depends on TATLPWS
	default n
	help
	  This will enable debug configuration for this module

endif # TATLPWS
```

## validation/hardware/tat/tat/tatlrf/Kconfig
```kconfig
#
# TatlRf configuration
#

menuconfig TATLRF
	bool "TatlRf"
	depends on DTHSRVHELPER && TATLMODEMSRV && TATTOOLS
	help
	  depends on DTHSRVHELPER, TATLMODEMSRV and TATTOOLS

if TATLRF

config TATLRF_DIR
	string
	default ../tat/tat/tatlrf

config TATLRF_DEPS
	string
	default "DTHSRVHELPER TATLMODEMSRV TATTOOLS"

config TATLRF_STRIP_DISABLED
	bool "Disable strip"
	depends on TATLRF
	default n
	help
	  This will disable strip for this module

config TATLRF_DEBUG_ENABLED
	bool "Enable debug"
	depends on TATLRF
	default n
	help
	  This will enable debug configuration for this module

endif # TATLRF
```

## validation/hardware/tat/tat/tatlsd/Kconfig
```kconfig
#
# TatlSd configuration
#

menuconfig TATLSD
	bool "TatlSd"
	depends on DTHSRVHELPER && LIBAB && TATTOOLS && POWERSERVICES
	help
	  depends on DTHSRVHELPER, LIBAB, TATTOOLS and POWERSERVICES

if TATLSD

config TATLSD_DIR
	string
	default ../tat/tat/tatlsd

config TATLSD_DEPS
	string
	default "DTHSRVHELPER LIBAB TATTOOLS POWERSERVICES"

config TATLSD_STRIP_DISABLED
	bool "Disable strip"
	depends on TATLSD
	default n
	help
	  This will disable strip for this module

config TATLSD_DEBUG_ENABLED
	bool "Enable debug"
	depends on TATLSD
	default n
	help
	  This will enable debug configuration for this module

endif # TATLSD
```

## validation/hardware/tat/tat/tatlsim/Kconfig
```kconfig
#
# TatlSim configuration
#

menuconfig TATLSIM
	bool "TatlSim"
	depends on DTHSRVHELPER && TATLMODEMSRV && TATTOOLS && LIBAB && LIBTATASYNC
	help
	  depends on DTHSRVHELPER, TATLMODEMSRV, TATTOOLS and LIBAB && LIBTATASYNC

if TATLSIM

config TATLSIM_DIR
	string
	default ../tat/tat/tatlsim

config TATLSIM_DEPS
	string
	default "DTHSRVHELPER TATLMODEMSRV TATTOOLS LIBAB LIBTATASYNC"

config TATLSIM_STRIP_DISABLED
	bool "Disable strip"
	depends on TATLSIM
	default n
	help
	  This will disable strip for this module

config TATLSIM_DEBUG_ENABLED
	bool "Enable debug"
	depends on TATLSIM
	default n
	help
	  This will enable debug configuration for this module

endif # TATLSIM
```

## validation/hardware/tat/tat/tatlsys/Kconfig
```kconfig
#
# TatlSys configuration
#

menuconfig TATLSYS
	bool "TatlSys"
	depends on DTHSRVHELPER && TATTOOLS
	help
	  depends on DTHSRVHELPER, TATTOOLS

if TATLSYS

config TATLSYS_DIR
	string
	default ../tat/tat/tatlsys

config TATLSYS_DEPS
	string
	default "DTHSRVHELPER TATTOOLS"

config TATLSYS_STRIP_DISABLED
	bool "Disable strip"
	depends on TATLSYS
	default n
	help
	  This will disable strip for this module

config TATLSYS_DEBUG_ENABLED
	bool "Enable debug"
	depends on TATLSYS
	default n
	help
	  This will enable debug configuration for this module

endif # TATLSYS
```

## validation/hardware/tat/tat/tatltest/Kconfig
```kconfig
#
# Tatltest configuration
#

menuconfig TATLTEST
	bool "Tatltest"
	depends on TATTOOLS && DTHSRVHELPER && LIBAB && LIBDB && LIBTATASYNC
	help
	  depends on TATTOOLS && DTHSRVHELPER && LIBAB && LIBDB && LIBTATASYNC

if TATLTEST

config TATLTEST_DIR
	string
	default ../tat/tat/tatltest

config TATLTEST_DEPS
	string
	default "TATTOOLS DTHSRVHELPER LIBAB LIBDB LIBTATASYNC"

config TATLTEST_STRIP_DISABLED
	bool "Disable strip"
	depends on TATLTEST
	default n
	help
	  This will disable strip for this module

config TATLTEST_DEBUG_ENABLED
	bool "Enable debug"
	depends on TATLTEST
	default n
	help
	  This will enable debug configuration for this module

endif # TATLTEST
```

## validation/hardware/tat/tat/tatlvideo/Kconfig
```kconfig
#
# TatlVideo configuration
#

menuconfig TATLVIDEO
	bool "TatlVideo"
	depends on DTHSRVHELPER && TATLIQTUNING && TATTOOLS && VIDEOSERVICES && CAMERASERVICES
	help
	  depends on DTHSRVHELPER, TATLIQTUNING, TATTOOLS, VIDEOSERVICES and CAMERASERVICES

if TATLVIDEO

config TATLVIDEO_DIR
	string
	default ../tat/tat/tatlvideo

config TATLVIDEO_DEPS
	string
	default "DTHSRVHELPER TATLIQTUNING TATTOOLS VIDEOSERVICES CAMERASERVICES"

config TATLVIDEO_STRIP_DISABLED
	bool "Disable strip"
	depends on TATLVIDEO
	default n
	help
	  This will disable strip for this module

config TATLVIDEO_DEBUG_ENABLED
	bool "Enable debug"
	depends on TATLVIDEO
	default n
	help
	  This will enable debug configuration for this module

endif # TATLVIDEO
```

## validation/hardware/tat/tat/tattools/Kconfig
```kconfig
#
# TatTools configuration
#

menuconfig TATTOOLS
	bool "TatTools"
	help
	  

if TATTOOLS

config TATTOOLS_DIR
	string
	default ../tat/tat/tattools

config TATTOOLS_DEPS
	string
	default ""

config TATTOOLS_STRIP_DISABLED
	bool "Disable strip"
	depends on TATTOOLS
	default n
	help
	  This will disable strip for this module

config TATTOOLS_DEBUG_ENABLED
	bool "Enable debug"
	depends on TATTOOLS
	default n
	help
	  This will enable debug configuration for this module

endif # TATTOOLS
```
