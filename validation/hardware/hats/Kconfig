## validation/hardware/hats/Kconfig
```kconfig
menu "General Setup"

config KERNELVERSION
	string "Hats version"
	default "Please declare me !"
config ENABLE_EXTRA_CFLAGS
	bool "Enable Extra Flags"
	default n
	help
		Activate extra compiler options.
config EXTRA_CFLAGS
	string "Extra Cflags"
	default "-Wall -Werror -Wextra -O2"
	depends on ENABLE_EXTRA_CFLAGS
	help
		By default, it will enable theses arguments in CFLAGS variables :
		-Wall -Werror -Wextra -O2
endmenu

menu "Hardware revisions"
choice
 prompt "Analog Baseband revision"
 default AB_HW_REVISION_2.0
 help
  This define the reference hardware revision of Analog Baseband chip.
config AB_HW_REVISION_1.0
 bool "1.0"
config AB_HW_REVISION_2.0
 bool "2.0"
config AB_HW_REVISION_3.0
 depends on AB_LIB_8500
 bool "3.0"
endchoice

choice
 prompt "Digital Baseband revision"
 default DB_HW_REVISION_8500
 help
  This define the reference hardware revision of Digital Baseband chip.
config DB_HW_REVISION_8500
 bool "8500"
config DB_HW_REVISION_9540
 bool "9540"
config DB_HW_REVISION_X600
 bool "x600"
endchoice

choice
 prompt "Analog Baseband library"
 default AB_LIB_8500
 help
  This define the reference hardware revision of Analog Baseband chip.
config AB_LIB_8500
 bool "lAB8500"
config AB_LIB_8505
 bool "lAB8505"
config AB_LIB_9540
 bool "lAB9540"
config AB_LIB_X600
 bool "lABX600"
endchoice

choice
 prompt "Modem type"
 default MODEM_TYPE_U8500
 help
  This define the reference hardware modem chip.
config MODEM_TYPE_U8500
 bool "u8500 integrated modem"
config MODEM_TYPE_NONE
 bool "No modem"
endchoice
endmenu

menu "Debug options"
config COMPILE_LOGS
	bool "Enable compile logs per module"
	default n
	help
		This switch will enable log generation for each module compiled.
		All these logs will be placed in $(HATS_OBJ)/logs directory.
endmenu

menu "Toolchain"
 config ENABLE_TOOLCHAIN
	bool "Copy libraries from CodeSourcery toolchain"
	default y
	help
		This switch will copy standard C libraries from CodeSourcery toolchain
		for HATS.
 config STRIP_TOOLCHAIN
	bool "Strip toolchain libraries"
	default y
	depends on ENABLE_TOOLCHAIN
	help
		This switch will strip toolchain libraries to save disk space.
endmenu

source "connectivityservices/Kconfig" skippable

menu "Hats Packages"
source "tools/autotest/Kconfig"
source "busybox/Kconfig"
source "gdb/Kconfig"
source "genext2fs/Kconfig"
source "iptables/Kconfig"
source "libpng/Kconfig"
source "libxml2/Kconfig"
source "LpDDR2/Kconfig"
source "memtester/Kconfig"
source "modemfs/Kconfig"
source "ncurses/Kconfig"
source "openssl/Kconfig"
source "ppp/Kconfig"
source "strace/Kconfig"
source "tools/sk-utils/Kconfig"
source "zlib/Kconfig"
endmenu

if MODEM_TYPE_U8500
source "miniape/Kconfig" skippable
source "modemservices/Kconfig" skippable
endif

source "multimediaservices/Kconfig" skippable

source "powerservices/Kconfig" skippable

menu "DTH Services Packages"
source "../tat/tat/Kconfig" skippable
source "../hats_userland/dthservices/Kconfig" skippable

source "../tat/DthFramework/Kconfig" skippable
source "../hats_userland/dthframework/Kconfig" skippable

source "../tat/application/Kconfig" skippable
source "../hats_userland/application/Kconfig" skippable

source "../tat/generalservices/Kconfig" skippable
source "../hats_userland/hats_sharedlib/Kconfig" skippable
endmenu
```

## validation/hardware/hats/LpDDR2/Kconfig
```kconfig
#
# LpDDR2 configuration
#

menuconfig LPDDR2
	bool "LpDDR2 Configuration"
	help
	  Tool to read/write DDR2 content from Linux userspace.

if LPDDR2

config LPDDR2_DIR
	string
	default ./LpDDR2

config LPDDR2_DEPS
	string
	default ""

config LPDDR2_STRIP_DISABLED
	bool "Disable strip"
	depends on LPDDR2
	default n
	help
	  This will disable strip for this module

config LPDDR2_DEBUG_ENABLED
	bool "Enable debug"
	depends on LPDDR2
	default n
	help
	  This will enable debug configuration for this module

endif # LPDDR2
```

## validation/hardware/hats/busybox/Kconfig
```kconfig
#
# Busybox configuration
#

menuconfig BUSYBOX
	bool "Busybox Configuration"
	help
	  BusyBox: The Swiss Army Knife of Embedded Linux

if BUSYBOX

config BUSYBOX_DIR
	string
	default ./busybox

config BUSYBOX_DEPS
	string
	default ""

config BUSYBOX_DEBUG_ENABLED
	bool "Enable debug"
	depends on BUSYBOX
	default n
	help
	  This will enable debug configuration for this module

endif # BUSYBOX
```

## validation/hardware/hats/gdb/Kconfig
```kconfig
#
# Gdb configuration
#

menuconfig GDB
	bool "Gdb Configuration"
	help
	  GDB, the GNU Project debugger, allows you to see what is going on
	  `inside' another program while it executes -- or what another program
	  was doing at the moment it crashed.

if GDB

config GDB_DIR
	string
	default ./gdb

config GDB_DEPS
	string
	default ""

config GDB_DEBUG_ENABLED
	bool "Enable debug"
	depends on GDB
	default n
	help
	  This will enable debug configuration for this module

endif # GDB
```

## validation/hardware/hats/genext2fs/Kconfig
```kconfig
#
# Genext2fs configuration
#

menuconfig GENEXT2FS
	bool "Genext2fs Configuration"
	help
	  What is genext2fs you ask? Simply, it generates an ext2 filesystem as
	  a normal (i.e. non-root) user. It doesn't require you to mount the image
	  file to copy files on it. It doesn't even require you to be the superuser
	  to make device nodes or set group/user ids. 

if GENEXT2FS

config GENEXT2FS_DIR
	string
	default ./genext2fs

config GENEXT2FS_DEPS
	string
	default ""

config GENEXT2FS_DEBUG_ENABLED
	bool "Enable debug"
	depends on GENEXT2FS
	default n
	help
	  This will enable debug configuration for this module

endif # GENEXT2FS
```

## validation/hardware/hats/iptables/Kconfig
```kconfig
#
# Iptables configuration
#

menuconfig IPTABLES
	bool "Iptables Configuration"
	help
	  iptables is the userspace command line program used to configure
	  the Linux 2.4.x and 2.6.x IPv4 packet filtering ruleset. 
	  It is targeted towards system administrators. 

if IPTABLES

config IPTABLES_DIR
	string
	default ./iptables

config IPTABLES_DEPS
	string
	default ""

config IPTABLES_DEBUG_ENABLED
	bool "Enable debug"
	depends on IPTABLES
	default n
	help
	  This will enable debug configuration for this module

endif # IPTABLES
```

## validation/hardware/hats/libpng/Kconfig
```kconfig
#
# Libpng configuration
#

menuconfig LIBPNG
	bool "Libpng Configuration"
	depends on ZLIB
	help
	  libpng is the official PNG reference library. It supports almost all
	  PNG features, is extensible, and has been extensively tested
	  for over 15 years.

if LIBPNG

config LIBPNG_DIR
	string
	default ./libpng

config LIBPNG_DEPS
	string
	default "ZLIB"

config LIBPNG_DEBUG_ENABLED
	bool "Enable debug"
	depends on LIBPNG
	default n
	help
	  This will enable debug configuration for this module

endif # LIBPNG
```

## validation/hardware/hats/libxml2/Kconfig
```kconfig
#
# Libxml2 configuration
#

menuconfig LIBXML2
	bool "Libxml2 Configuration"
	help
	  Libxml2 is the XML C parser and toolkit developed for the Gnome project
	  (but usable outside of the Gnome platform), it is free software available
	  under the MIT License.

if LIBXML2

config LIBXML2_DIR
	string
	default ./libxml2

config LIBXML2_DEPS
	string
	default ""

config LIBXML2_DEBUG_ENABLED
	bool "Enable debug"
	depends on LIBXML2
	default n
	help
	  This will enable debug configuration for this module

endif # LIBXML2
```

## validation/hardware/hats/memtester/Kconfig
```kconfig
#
# Memtester configuration
#

menuconfig MEMTESTER
	bool "Memtester Configuration"
	help
	  A userspace utility for testing the memory subsystem for faults.

if MEMTESTER

config MEMTESTER_DIR
	string
	default ./memtester

config MEMTESTER_DEPS
	string
	default ""

config MEMTESTER_DEBUG_ENABLED
	bool "Enable debug"
	depends on MEMTESTER
	default n
	help
	  This will enable debug configuration for this module

endif # MEMTESTER
```

## validation/hardware/hats/modemfs/Kconfig
```kconfig
#
# Modemfs configuration
#

menuconfig MODEMFS
	bool "Modemfs Configuration"
	depends on MODEM_TYPE_U8500
	help
	  Copy modem filesystem on target.

if MODEMFS

config MODEMFS_DIR
	string
	default ./modemfs

config MODEMFS_DEPS
	string
	default ""

config MODEMFS_DEBUG_ENABLED
	bool "Enable debug"
	depends on MODEMFS
	default n
	help
	  This will enable debug configuration for this module

endif # MODEMFS
```

## validation/hardware/hats/ncurses/Kconfig
```kconfig
#
# Ncurses configuration
#

menuconfig NCURSES
	bool "Ncurses Configuration"
	help
	  The Ncurses (new curses) library is a free software emulation of curses
	  in System V Release 4.0, and more. It uses Terminfo format, supports pads
	  and color and multiple highlights and forms characters and function-key
	  mapping, and has all the other SYSV-curses enhancements over BSD Curses.

if NCURSES

config NCURSES_DIR
	string
	default ./ncurses

config NCURSES_DEPS
	string
	default ""

config NCURSES_DEBUG_ENABLED
	bool "Enable debug"
	depends on NCURSES
	default n
	help
	  This will enable debug configuration for this module

endif # NCURSES
```

## validation/hardware/hats/openssl/Kconfig
```kconfig
#
# Openssl configuration
#

menuconfig OPENSSL
	bool "Openssl Configuration"
	help
	  The OpenSSL Project is a collaborative effort to develop a robust,
	  commercial-grade, full-featured, and Open Source toolkit implementing
	  the Secure Sockets Layer (SSL v2/v3) and Transport Layer Security (TLS v1)
	  protocols as well as a full-strength general purpose cryptography library.
	  The project is managed by a worldwide community of volunteers that use the
	  Internet to communicate, plan, and develop the OpenSSL toolkit and its
	  related documentation.

if OPENSSL

config OPENSSL_DIR
	string
	default ./openssl

config OPENSSL_DEPS
	string
	default ""

config OPENSSL_DEBUG_ENABLED
	bool "Enable debug"
	depends on OPENSSL
	default n
	help
	  This will enable debug configuration for this module

endif # OPENSSL
```

## validation/hardware/hats/ppp/Kconfig
```kconfig
#
# Ppp configuration
#

menuconfig PPP
	bool "Ppp Configuration"
	help
	  Point-to-Point Protocol

if PPP

config PPP_DIR
	string
	default ./ppp

config PPP_DEPS
	string
	default ""

config PPP_DEBUG_ENABLED
	bool "Enable debug"
	depends on PPP
	default n
	help
	  This will enable debug configuration for this module

endif # PPP
```

## validation/hardware/hats/strace/Kconfig
```kconfig
#
# Strace configuration
#

menuconfig STRACE
	bool "Strace Configuration"
	help
	  strace is a system call tracer, i.e. a debugging tool
	  which prints out a trace of all the system calls made
	  by a another process/program.

if STRACE

config STRACE_DIR
	string
	default ./strace

config STRACE_DEPS
	string
	default ""

config STRACE_DEBUG_ENABLED
	bool "Enable debug"
	depends on STRACE
	default n
	help
	  This will enable debug configuration for this module

endif # STRACE
```

## validation/hardware/hats/tools/autotest/Kconfig
```kconfig
#
# Autotest configuration
#

menuconfig AUTOTEST
	bool "Autotest Configuration"
	depends on AB_APE
	help
	  Various scripts used by test teams

if AUTOTEST

config AUTOTEST_DIR
	string
	default ./tools/autotest

config AUTOTEST_DEPS
	string
	default ""

config AUTOTEST_DEBUG_ENABLED
	bool "Enable debug"
	depends on AUTOTEST
	default n
	help
	  This will enable debug configuration for this module

endif # AUTOTEST
```

## validation/hardware/hats/tools/sk-utils/Kconfig
```kconfig
#
# Sk-utils configuration
#

menuconfig SK-UTILS
	bool "Sk-utils Configuration"
	help
	  This file provides utilities used by 'sk' shell script

if SK-UTILS

config SK-UTILS_DIR
	string
	default ./tools/sk-utils

config SK-UTILS_DEPS
	string
	default ""

config SK-UTILS_STRIP_DISABLED
	bool "Disable strip"
	depends on SK-UTILS
	default n
	help
	  This will disable strip for this module

config SK-UTILS_DEBUG_ENABLED
	bool "Enable debug"
	depends on SK-UTILS
	default n
	help
	  This will enable debug configuration for this module

endif # SK-UTILS
```

## validation/hardware/hats/zlib/Kconfig
```kconfig
#
# Zlib configuration
#

menuconfig ZLIB
	bool "Zlib Configuration"
	help
	  A massively spiffy yet delicately unobtrusive compression library.

if ZLIB

config ZLIB_DIR
	string
	default ./zlib

config ZLIB_DEPS
	string
	default ""

config ZLIB_DEBUG_ENABLED
	bool "Enable debug"
	depends on ZLIB
	default n
	help
	  This will enable debug configuration for this module

endif # ZLIB
```

## validation/hardware/multimedia/multimediaservices/Kconfig
```kconfig
menu "MultimediaServices Configuration"

menu "Audio Configuration"
source "multimediaservices/alsa-utils/Kconfig"
source "multimediaservices/alsa-lib/Kconfig"
source "multimediaservices/audioservices/Kconfig"
endmenu

menu "Video Configuration"
source "multimediaservices/videoservices/Kconfig"
endmenu

menu "IQ Tuning Configuration"
source "multimediaservices/iqtservices/Kconfig"
endmenu

menu "Camera Configuration"
source "multimediaservices/cameraservices/Kconfig"
endmenu

endmenu
```

## validation/hardware/multimedia/multimediaservices/alsa-lib/Kconfig
```kconfig
#
# Alsa-lib configuration
#

menuconfig ALSALIB
	bool "Alsa-lib Configuration"
	help
	  This module provides alsa library

if ALSALIB

config ALSALIB_DIR
	string
	default ./multimediaservices/alsa-lib

config ALSALIB_DEPS
	string
	default ""

config ALSALIB_STRIP_DISABLED
	bool "Disable strip"
	depends on ALSALIB
	default n
	help
	  This will disable strip for this module

config ALSALIB_DEBUG_ENABLED
	bool "Enable debug"
	depends on ALSALIB
	default n
	help
	  This will enable debug configuration for this module

endif # ALSALIB
```

## validation/hardware/multimedia/multimediaservices/alsa-utils/Kconfig
```kconfig
#
# Alsa-utils configuration
#

menuconfig ALSAUTILS
	bool "Alsa-utils Configuration"
	depends on NCURSES && ALSALIB
	help
	  This module provides alsa tools to control soundcard

if ALSAUTILS

config ALSAUTILS_DIR
	string
	default ./multimediaservices/alsa-utils

config ALSAUTILS_DEPS
	string
	default "ALSALIB NCURSES"

config ALSAUTILS_STRIP_DISABLED
	bool "Disable strip"
	depends on ALSAUTILS
	default n
	help
	  This will disable strip for this module

config ALSAUTILS_DEBUG_ENABLED
	bool "Enable debug"
	depends on ALSAUTILS
	default n
	help
	  This will enable debug configuration for this module

endif # ALSAUTILS
```

## validation/hardware/multimedia/multimediaservices/audioservices/Kconfig
```kconfig
#
# Audioservices configuration
#

menuconfig AUDIOSERVICES
	bool "Audioservices Configuration"
	depends on (AB_APE && (AB_LIB_9540 || AB_LIB_X600 || AB_LIB_8500 || AB_LIB_8505))
	help
	  This module provides audio tools to control and test Ux500 board

if AUDIOSERVICES

config AUDIOSERVICES_DIR
	string
	default ./multimediaservices/audioservices

config AUDIOSERVICES_DEPS
	string
	default "AB_APE"

config AUDIOSERVICES_STRIP_DISABLED
	bool "Disable strip"
	depends on AUDIOSERVICES
	default n
	help
	  This will disable strip for this module

config AUDIOSERVICES_DEBUG_ENABLED
	bool "Enable debug"
	depends on AUDIOSERVICES
	default n
	help
	  This will enable debug configuration for this module

endif # AUDIOSERVICES
```
