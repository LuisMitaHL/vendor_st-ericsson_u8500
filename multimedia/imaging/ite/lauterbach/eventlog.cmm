OPEN #1 timelog /Create
var.write #1 "grabLRinfo" eventtimelog.grabLRinfo.time
var.write #1 "grabLRinfo" eventtimelog.grabLRinfo.timestamp
var.write #1 "grabLRinfoid" eventtimelog.grabLRinfo.infoid
var.write #1 "grabLRerror" eventtimelog.grabLRerror.time
var.write #1 "grabLRerror" eventtimelog.grabLRerror.timestamp
var.write #1 "grabLRerrorid" eventtimelog.grabLRerror.infoid
var.write #1 "grabLRdebug" eventtimelog.grabLRdebug.time
var.write #1 "grabLRdebug" eventtimelog.grabLRdebug.timestamp
var.write #1 "grabLRdebugid" eventtimelog.grabLRdebug.infoid
var.write #1 "grabHRinfo" eventtimelog.grabHRinfo.time
var.write #1 "grabHRinfo" eventtimelog.grabHRinfo.timestamp
var.write #1 "grabHRinfoid" eventtimelog.grabHRinfo.infoid
var.write #1 "grabHRerror" eventtimelog.grabHRerror.time
var.write #1 "grabHRerror" eventtimelog.grabHRerror.timestamp
var.write #1 "grabHRerrorid" eventtimelog.grabHRerror.infoid
var.write #1 "grabHRdebug" eventtimelog.grabHRdebug.time
var.write #1 "grabHRdebug" eventtimelog.grabHRdebug.timestamp
var.write #1 "grabHRdebugid" eventtimelog.grabHRdebug.infoid
var.write #1 "grabBMSinfo" eventtimelog.grabBMSinfo.time
var.write #1 "grabBMSinfo" eventtimelog.grabBMSinfo.timestamp
var.write #1 "grabBMSinfoid" eventtimelog.grabBMSinfo.infoid
var.write #1 "grabBMSerror" eventtimelog.grabBMSerror.time
var.write #1 "grabBMSerror" eventtimelog.grabBMSerror.timestamp
var.write #1 "grabBMSerrorid" eventtimelog.grabBMSerror.infoid
var.write #1 "grabBMSdebug" eventtimelog.grabBMSdebug.time
var.write #1 "grabBMSdebug" eventtimelog.grabBMSdebug.timestamp
var.write #1 "grabBMSdebugid" eventtimelog.grabBMSdebug.infoid
var.write #1 "grabBMLinfo" eventtimelog.grabBMLinfo.time
var.write #1 "grabBMLinfo" eventtimelog.grabBMLinfo.timestamp
var.write #1 "grabBMLinfoid" eventtimelog.grabBMLinfo.infoid
var.write #1 "grabBMLerror" eventtimelog.grabBMLerror.time
var.write #1 "grabBMLerror" eventtimelog.grabBMLerror.timestamp
var.write #1 "grabBMLerrorid" eventtimelog.grabBMLerror.infoid
var.write #1 "grabBMLdebug" eventtimelog.grabBMLdebug.time
var.write #1 "grabBMLdebug" eventtimelog.grabBMLdebug.timestamp
var.write #1 "grabBMLdebugid" eventtimelog.grabBMLdebug.infoid
var.write #1 "ispctlinfo" eventtimelog.ispctlinfo.time
var.write #1 "ispctlinfo" eventtimelog.ispctlinfo.timestamp
var.write #1 "ispctlinfoid" eventtimelog.ispctlinfo.infoid
var.write #1 "ispctlerror" eventtimelog.ispctlerror.time
var.write #1 "ispctlerror" eventtimelog.ispctlerror.timestamp
var.write #1 "ispctlerrorid" eventtimelog.ispctlerror.infoid
var.write #1 "ispzoominfo" eventtimelog.ispzoominfo.time
var.write #1 "ispzoominfo" eventtimelog.ispzoominfo.timestamp
var.write #1 "ispzoominfoid" eventtimelog.ispzoominfo.infoid
var.write #1 "ispstatinfo" eventtimelog.ispstatinfo.time
var.write #1 "ispstatinfo" eventtimelog.ispstatinfo.timestamp
var.write #1 "ispstatinfoid" eventtimelog.ispstatinfo.infoid
var.write #1 "ispfocusinfo" eventtimelog.ispfocusinfo.time
var.write #1 "ispfocusinfo" eventtimelog.ispfocusinfo.timestamp
var.write #1 "ispfocusinfoid" eventtimelog.ispfocusinfo.infoid
CLOSE #1

