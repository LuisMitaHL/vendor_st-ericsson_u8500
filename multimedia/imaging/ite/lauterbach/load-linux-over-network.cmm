
GLOBAL &usb &platform

do ..\..\imaging\ite\lauterbach\config_terminal.cmm

;term.out "./env_init.sh" 
;term.out %BYTE 0xD
