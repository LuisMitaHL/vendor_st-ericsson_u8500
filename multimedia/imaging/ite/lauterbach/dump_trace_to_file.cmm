entry &file
data.save.binary &file y.range(trace_buffer)
