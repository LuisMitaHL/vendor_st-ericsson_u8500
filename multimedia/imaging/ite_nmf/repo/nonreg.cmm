dialog
(&
HEADER "Non reg select"
BOX "LR"
pos 1. 1. 25.
LRNREG1: CHECKBOX "LR datapath YUV422RI" ""
BOX "HR"
pos 1. 3. 25.
HRNREG1: CHECKBOX "HR datapath YUV420MB_D" ""
pos 1. 4. 25.
HRNREG2: CHECKBOX "HR datapath YUV420RP_I420" ""
BOX "LRHR"
pos 1. 6. 25.
LRHRNREG1: CHECKBOX "LR YUV422RI HR YUV420MB_D SAME AR" ""
pos 1. 7. 25.
LRHRNREG2: CHECKBOX "LR YUV422RI HR YUV420RP_I420 SAME AR" ""
pos 1. 8. 25.
LRHRNREG3: CHECKBOX "LR YUV422RI HR YUV420MB_D DIFF AR" ""
pos 1. 9. 25.
LRHRNREG4: CHECKBOX "LR YUV422RI HR YUV420RP_I420 DIFF AR" ""
BOX "BMS"
pos 1. 11. 25.
BMSNREG1: CHECKBOX "BMS datapath" ""
pos 1. 12. 25.
BMSNREG2: CHECKBOX "BMS VIDEO datapath" ""
BOX "BML"
pos 1. 14. 25.
BMLNREG1: CHECKBOX "BML LR YUV422RI HR YUV420MB_D" ""
pos 1. 15. 25.
BMLNREG2: CHECKBOX "BML LR YUV422RI HR YUV420RP_I420" ""
pos 1. 16. 25.
BMLNREG3: CHECKBOX "BML LR RGB565 HR YUV422RI" ""
pos 1. 17. 25.
BMLNREG4: CHECKBOX "BML VIDEO LR YUV422RI HR YUV420MB_D" ""
BOX "ZOOM"
pos 1. 19. 25.
ZOOMNREG1: CHECKBOX "ZOOM BML Still LR YUV422RI HR YUV420MB_D" ""
pos 1. 20. 25.
ZOOMNREG2: CHECKBOX "ZOOM STREAMING LR YUV422RI HR YUV420MB_D" ""
pos 1. 21. 25.
ZOOM3: CHECKBOX "Zoom same A/R" ""
pos 1. 22. 25.
ZOOM4: CHECKBOX "Zoom diff A/R" ""
pos 1. 24. 5.
DEFBUTTON "OK" "continue"
)
; HEX CheckBox is set
dialog.set LRNREG1
dialog.set HRNREG1
dialog.set HRNREG2
dialog.set LRHRNREG1
dialog.set LRHRNREG2
dialog.set BMSNREG1
dialog.set BMSNREG2
dialog.set BMLNREG1
dialog.set BMLNREG2
dialog.set ZOOMNREG1
dialog.set ZOOMNREG2
dialog.set ZOOM3
dialog.set ZOOM4
stop

if dialog.boolean(LRNREG1)
V nonregselect.lr.nonreg1 = 1
else
V nonregselect.lr.nonreg1 = 0

if dialog.boolean(HRNREG1)
V nonregselect.hr.nonreg1 = 1
else
V nonregselect.hr.nonreg1 = 0

if dialog.boolean(HRNREG2)
V nonregselect.hr.nonreg2 = 1
else
V nonregselect.hr.nonreg2 = 0

if dialog.boolean(LRHRNREG1)
V nonregselect.lrhr.nonreg1 = 1
else
V nonregselect.lrhr.nonreg1 = 0

if dialog.boolean(LRHRNREG2)
V nonregselect.lrhr.nonreg2 = 1
else
V nonregselect.lrhr.nonreg2 = 0

if dialog.boolean(LRHRNREG3)
V nonregselect.lrhr.nonreg3 = 1
else
V nonregselect.lrhr.nonreg3 = 0

if dialog.boolean(LRHRNREG4)
V nonregselect.lrhr.nonreg4 = 1
else
V nonregselect.lrhr.nonreg4 = 0

if dialog.boolean(BMSNREG1)
V nonregselect.bms.nonreg1 = 1
else
V nonregselect.bms.nonreg1 = 0

if dialog.boolean(BMSNREG2)
V nonregselect.bms.nonreg2 = 1
else
V nonregselect.bms.nonreg2 = 0

if dialog.boolean(BMLNREG1)
V nonregselect.bml.nonreg1 = 1
else
V nonregselect.bml.nonreg1 = 0

if dialog.boolean(BMLNREG2)
V nonregselect.bml.nonreg2 = 1
else
V nonregselect.bml.nonreg2 = 0

if dialog.boolean(BMLNREG3)
V nonregselect.bml.nonreg3 = 1
else
V nonregselect.bml.nonreg3 = 0

if dialog.boolean(BMLNREG4)
V nonregselect.bml.nonreg4 = 1
else
V nonregselect.bml.nonreg4 = 0

if dialog.boolean(ZOOMNREG1)
V nonregselect.zoom.nonreg1 = 1
else
V nonregselect.zoom.nonreg1 = 0
if dialog.boolean(ZOOMNREG2)
V nonregselect.zoom.nonreg2 = 1
else
V nonregselect.zoom.nonreg2 = 0

if dialog.boolean(ZOOM3)
V nonregselect.bms.nonreg3 = 1
else
V nonregselect.bms.nonreg3 = 0

if dialog.boolean(ZOOM4)
V nonregselect.bms.nonreg4 = 1
else
V nonregselect.bms.nonreg5 = 0

dialog.end
enddo

