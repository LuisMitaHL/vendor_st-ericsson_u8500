do  ../../../../osttools/ostscripts/scripts/ost.cmm ostdico_list.txt linux no
